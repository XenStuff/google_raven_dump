/dts-v1/;

/ {
	board_id = <0x201>;
	board_rev = <0x200>;

	__fixups__ {
		V_SYS_dummy = "/fragment@66/__overlay__/cs35l41@40:VP-supply:0", "/fragment@66/__overlay__/cs35l41@41:VP-supply:0";
		acpm_mbox_test = "/fragment@16:target:0";
		acpm_mfd_bus0 = "/fragment@14:target:0";
		acpm_mfd_bus1 = "/fragment@15:target:0", "/fragment@73:target:0";
		aoc = "/fragment@26:target:0", "/fragment@67:target:0";
		aoc_snd_card = "/fragment@61:target:0";
		clock = "/fragment@lwiscamera/__overlay__/sensor@0:clocks:0", "/fragment@lwiscamera/__overlay__/sensor@0:clocks:8", "/fragment@lwiscamera/__overlay__/sensor@2:clocks:0", "/fragment@lwiscamera/__overlay__/sensor@2:clocks:8", "/fragment@lwiscamera/__overlay__/sensor@1:clocks:0", "/fragment@lwiscamera/__overlay__/sensor@1:clocks:8", "/fragment@lwiscamera/__overlay__/actuator@0:clocks:0", "/fragment@lwiscamera/__overlay__/actuator@0:clocks:8", "/fragment@lwiscamera/__overlay__/eeprom@0:clocks:0", "/fragment@lwiscamera/__overlay__/eeprom@0:clocks:8", "/fragment@lwiscamera/__overlay__/eeprom@1:clocks:0", "/fragment@lwiscamera/__overlay__/eeprom@1:clocks:8", "/fragment@lwiscamera/__overlay__/eeprom@2:clocks:0", "/fragment@lwiscamera/__overlay__/eeprom@2:clocks:8", "/fragment@48/__overlay__/st21nfc@08:clocks:0";
		cp_msi_rmem = "/fragment@modemif/__overlay__/cp_shmem:memory-region:4";
		cp_rmem = "/fragment@modemif/__overlay__/cp_shmem:memory-region:0";
		cp_rmem_1 = "/fragment@modemif/__overlay__/cp_shmem:memory-region:8";
		cp_rmem_2 = "/fragment@modemif/__overlay__/cp_shmem:memory-region:12";
		cp_tm1 = "/fragment@39:target:0", "/fragment@40/__overlay__/cp_on_chip_0:thermal-sensors:0", "/fragment@40/__overlay__/cp_on_chip_1:thermal-sensors:0", "/fragment@40/__overlay__/cp_on_chip_2:thermal-sensors:0", "/fragment@40/__overlay__/cp_on_chip_3:thermal-sensors:0", "/fragment@40/__overlay__/cp_on_chip_4:thermal-sensors:0", "/fragment@40/__overlay__/cp_on_chip_5:thermal-sensors:0", "/fragment@40/__overlay__/cp_on_chip_6:thermal-sensors:0", "/fragment@40/__overlay__/rf2_therm:thermal-sensors:0", "/fragment@40/__overlay__/rf1_therm:thermal-sensors:0";
		dai_be_tdm0_rx = "/fragment@59:target:0";
		dai_be_tdm0_tx = "/fragment@60:target:0";
		drmdsim0 = "/fragment@44:target:0", "/fragment@72:target:0";
		drmdsim1 = "/fragment@45:target:0";
		gpa0 = "/fragment@14/__overlay__/s2mpg10mfd@00:s2mpg10,irq-gpio:0", "/fragment@14/__overlay__/s2mpg10mfd@00:interrupt-parent:0", "/fragment@15/__overlay__/s2mpg11mfd@00:s2mpg11,irq-gpio:0", "/fragment@15/__overlay__/s2mpg11mfd@00:interrupt-parent:0";
		gpa10 = "/fragment@20/__overlay__/button@3:gpios:0";
		gpa4 = "/fragment@55/__overlay__/gsc@0:gsc,ctdl_rst:0";
		gpa5 = "/fragment@14/__overlay__/s2mpg10mfd@00:gpios:0", "/fragment@14/__overlay__/s2mpg10mfd@00:gpios:12", "/fragment@14/__overlay__/s2mpg10mfd@00:gpios:24", "/fragment@14/__overlay__/s2mpg10mfd@00:gpios:36", "/fragment@14/__overlay__/s2mpg10mfd@00:gpios:48";
		gpa6 = "/fragment@3/__overlay__/btbcm:host-wakeup-gpios:0", "/fragment@34/__overlay__/goodixfp:interrupt-parent:0", "/fragment@34/__overlay__/goodixfp:fp-gpio-irq:0", "/fragment@56/__overlay__/bcm4775@0:mcu-resp-gpios:0", "/fragment@66/__overlay__/cs35l41@40:interrupt-parent:0";
		gpa7 = "/fragment@12/__overlay__/wlan:wl_host_wake:0", "/fragment@20/__overlay__/button@1:gpios:0";
		gpa8 = "/fragment@6/__overlay__/fusb307b@50:interrupt-parent:0", "/fragment@6/__overlay__/fusb307b@50:usbpd,usbpd_int:0", "/fragment@6/__overlay__/max77759tcpc@25:interrupt-parent:0", "/fragment@6/__overlay__/max77759tcpc@25:usbpd,usbpd_int:0", "/fragment@20/__overlay__/button@2:gpios:0", "/fragment@modemif/__overlay__/cpif:gpio_cp2ap_wake_up:0", "/fragment@48/__overlay__/st21nfc@08:interrupt-parent:0", "/fragment@48/__overlay__/st21nfc@08:irq-gpios:0", "/fragment@70/__overlay__/max77729pmic@0x66:max777x9,irq-gpio:0", "/fragment@70/__overlay__/max77729uic@0x25:max77729,irq-gpio:0", "/fragment@70/__overlay__/max77729fg@0x36:maxim,irq-gpio:0", "/fragment@70/__overlay__/max77729chrg@0x69:max77729,irq-gpio:0";
		gpa9 = "/fragment@modemif/__overlay__/cpif:gpio_cp2ap_cp_ps_hold:0", "/fragment@52/__overlay__/touchscreen@0:sec,irq_gpio:0", "/fragment@55/__overlay__/gsc@0:interrupt-parent:0", "/fragment@55/__overlay__/gsc@0:gsc,ctdl_ap_irq:0", "/fragment@66/__overlay__/cs35l41@41:interrupt-parent:0";
		gph0 = "/fragment@modemif/__overlay__/cpif:gpio_ap2cp_wake_up:0", "/fragment@modemif/__overlay__/cpif:gpio_ap2cp_dump_noti:0";
		gph1 = "/fragment@modemif/__overlay__/cpif:gpio_ap2cp_cp_pwr_on:0", "/fragment@modemif/__overlay__/cpif:gpio_ap2cp_pda_active:0", "/fragment@modemif/__overlay__/cpif:gpio_ap2cp_nreset_n:0", "/fragment@modemif/__overlay__/cpif:gpio_cp2ap_phone_active:0";
		gph2 = "/fragment@12/__overlay__/wlan:wl_dev_wake:0";
		gpio_keys = "/fragment@20:target:0";
		gpp0 = "/fragment@4/__overlay__/bcm4775@0:nstandby-gpios:0", "/fragment@56/__overlay__/bcm4775@0:host-req-gpios:0";
		gpp1 = "/fragment@4/__overlay__/bcm4775@0:mcu-req-gpios:0";
		gpp14 = "/fragment@3/__overlay__/btbcm:device-wakeup-gpios:0", "/fragment@12/__overlay__/wlan:wl_reg_on:0", "/fragment@25/__overlay__:pcie,wlan-gpio:0";
		gpp16 = "/fragment@3/__overlay__/btbcm:shutdown-gpios:0", "/fragment@33/__overlay__:gpios:0", "/fragment@33/__overlay__:gpios:12", "/fragment@66/__overlay__/cs35l41@40:reset-gpios:0";
		gpp19 = "/fragment@14/__overlay__/s2mpg10mfd@00:gpios:60", "/fragment@14/__overlay__/s2mpg10mfd@00:gpios:72", "/fragment@15/__overlay__/s2mpg11mfd@00:gpios:0", "/fragment@15/__overlay__/s2mpg11mfd@00:gpios:12";
		gpp23 = "/fragment@66/__overlay__/cs35l41@41:reset-gpios:0";
		gpp24 = "/fragment@44/__overlay__/panel@0:reset-gpios:0", "/fragment@44/__overlay__/panel@1:reset-gpios:0", "/fragment@48/__overlay__/st21nfc@08:reset-gpios:0", "/fragment@66/__overlay__/drv2624_haptics@5a:ti,reset-gpio:0";
		gpp26 = "/fragment@48/__overlay__/st21nfc@08:clkreq-gpios:0", "/fragment@48/__overlay__/st21nfc@08:pidle-gpios:0", "/fragment@52/__overlay__/touchscreen@0:sec,switch_gpio:0", "/fragment@52/__overlay__/touchscreen@0:sec,reset_gpio:0";
		gpp27 = "/fragment@lwiscamera/__overlay__/flash@0:enable-gpios:0", "/fragment@lwiscamera/__overlay__/flash@0:enable-gpios:12", "/fragment@lwiscamera/__overlay__/flash@0:enable-gpios:24";
		gpp4 = "/fragment@30/__overlay__:gpios:0", "/fragment@30/__overlay__:gpios:12", "/fragment@lwiscamera/__overlay__/sensor@2:reset-gpios:0", "/fragment@lwiscamera/__overlay__/eeprom@2:reset-gpios:0", "/fragment@34/__overlay__/goodixfp:fp-gpio-reset:0";
		gpp6 = "/fragment@31/__overlay__:gpios:0", "/fragment@31/__overlay__:gpios:12", "/fragment@lwiscamera/__overlay__/sensor@0:reset-gpios:0", "/fragment@lwiscamera/__overlay__/sensor@1:reset-gpios:0", "/fragment@lwiscamera/__overlay__/eeprom@0:reset-gpios:0", "/fragment@lwiscamera/__overlay__/eeprom@1:reset-gpios:0";
		gpp8 = "/fragment@32/__overlay__:gpios:0", "/fragment@32/__overlay__:gpios:12";
		hsi2c12_bus = "/fragment@7:target:0", "/fragment@36:target:0";
		hsi2c7_bus = "/fragment@47:target:0";
		hsi2c8_bus = "/fragment@33/__overlay__:pinctrl-0:0", "/fragment@33/__overlay__:pinctrl-1:0", "/fragment@33/__overlay__:pinctrl-2:0", "/fragment@35/__overlay__:pinctrl-0:0", "/fragment@66/__overlay__:pinctrl-0:0";
		hsi2c_12 = "/fragment@6:target:0", "/fragment@70:target:0";
		hsi2c_2 = "/fragment@30:target:0", "/fragment@lwiscamera/__overlay__/sensor@2:i2c-bus:0", "/fragment@lwiscamera/__overlay__/eeprom@2:i2c-bus:0";
		hsi2c_3 = "/fragment@31:target:0", "/fragment@lwiscamera/__overlay__/sensor@0:i2c-bus:0", "/fragment@lwiscamera/__overlay__/actuator@0:i2c-bus:0", "/fragment@lwiscamera/__overlay__/eeprom@0:i2c-bus:0";
		hsi2c_4 = "/fragment@32:target:0", "/fragment@lwiscamera/__overlay__/sensor@1:i2c-bus:0", "/fragment@lwiscamera/__overlay__/eeprom@1:i2c-bus:0";
		hsi2c_7 = "/fragment@27:target:0", "/fragment@48:target:0";
		hsi2c_8 = "/fragment@33:target:0", "/fragment@lwiscamera/__overlay__/flash@0:i2c-bus:0", "/fragment@35:target:0", "/fragment@66:target:0";
		odm = "/fragment@3:target:0", "/fragment@34:target:0";
		pcie1_clkreq = "/fragment@12/__overlay__:pinctrl-0:0";
		pcie1_perst = "/fragment@12/__overlay__:pinctrl-0:4";
		pcie_0 = "/fragment@24:target:0";
		pcie_1 = "/fragment@12:target:0", "/fragment@25:target:0", "/fragment@49:target:0";
		pinctrl_0 = "/fragment@13:target:0", "/fragment@19:target:0", "/fragment@41:target:0", "/fragment@50:target:0", "/fragment@53:target:0", "/fragment@62:target:0", "/fragment@68:target:0";
		pinctrl_1 = "/fragment@1:target:0", "/fragment@8:target:0", "/fragment@10:target:0", "/fragment@18:target:0", "/fragment@42:target:0", "/fragment@57:target:0", "/fragment@63:target:0", "/fragment@69:target:0";
		pinctrl_4 = "/fragment@0:target:0", "/fragment@5:target:0", "/fragment@9:target:0", "/fragment@28:target:0", "/fragment@58:target:0", "/fragment@64:target:0";
		pinctrl_5 = "/fragment@29:target:0", "/fragment@46:target:0", "/fragment@51:target:0", "/fragment@54:target:0", "/fragment@65:target:0";
		pinctrl_6 = "/fragment@43:target:0", "/fragment@71:target:0";
		pinctrl_7 = "/fragment@11:target:0";
		s2mpu_hsi1 = "/fragment@modemif/__overlay__/cpif:s2mpu:0";
		sensor_mclk1_fn = "/fragment@lwiscamera/__overlay__/sensor@0:pinctrl-0:0";
		sensor_mclk1_out = "/fragment@lwiscamera/__overlay__/sensor@0:pinctrl-1:0";
		sensor_mclk2_fn = "/fragment@lwiscamera/__overlay__/sensor@2:pinctrl-0:0";
		sensor_mclk2_out = "/fragment@lwiscamera/__overlay__/sensor@2:pinctrl-1:0";
		sensor_mclk3_fn = "/fragment@lwiscamera/__overlay__/sensor@1:pinctrl-0:0";
		sensor_mclk3_out = "/fragment@lwiscamera/__overlay__/sensor@1:pinctrl-1:0";
		serial_0 = "/fragment@17:target:0";
		serial_16 = "/fragment@2:target:0";
		spi10_bus = "/fragment@55/__overlay__:pinctrl-0:0";
		spi10_cs_func = "/fragment@55/__overlay__:pinctrl-0:4";
		spi5_bus = "/fragment@4/__overlay__:pinctrl-0:0";
		spi5_cs_func = "/fragment@4/__overlay__:pinctrl-0:4";
		spi9_bus = "/fragment@38/__overlay__:pinctrl-0:0";
		spi9_cs_func = "/fragment@37:target:0", "/fragment@38/__overlay__:pinctrl-0:4";
		spi_10 = "/fragment@55:target:0";
		spi_11 = "/fragment@52:target:0";
		spi_5 = "/fragment@4:target:0", "/fragment@56:target:0";
		spi_9 = "/fragment@38:target:0";
		thermal_zones = "/fragment@40:target:0", "/fragment@74:target:0", "/fragment@75:target:0";
		udc = "/fragment@21:target:0";
		usbdrd_phy0 = "/fragment@22:target:0", "/fragment@23:target:0";
	};

	__local_fixups__ {

		fragment@12 {

			__overlay__ {
				pinctrl-0 = <0x8 0xc 0x10>;
			};
		};

		fragment@14 {

			__overlay__ {

				s2mpg10mfd@00 {
					pinctrl-0 = <0x0 0x4>;

					s2mpg10_gpio {
						gpio-ranges = <0x0>;
					};
				};
			};
		};

		fragment@15 {

			__overlay__ {

				s2mpg11mfd@00 {
					pinctrl-0 = <0x0>;

					s2mpg11_gpio {
						gpio-ranges = <0x0>;
					};
				};
			};
		};

		fragment@16 {

			__overlay__ {
				main-pmic = <0x0>;
				sub-pmic = <0x0>;
			};
		};

		fragment@20 {

			__overlay__ {
				pinctrl-0 = <0x0 0x4 0x8>;
			};
		};

		fragment@21 {

			__overlay__ {
				extcon = <0x0>;
			};
		};

		fragment@23 {

			__overlay__ {
				extcon = <0x0>;
				hs_tune_param = <0x0>;
				ss_tune_param = <0x0>;
				vdd085-supply = <0x0>;
				vdd18-supply = <0x0>;
				vdd30-supply = <0x0>;
				vdd_hsi-supply = <0x0>;
			};
		};

		fragment@24 {

			__overlay__ {
				vreg1-supply = <0x0>;
				vreg2-supply = <0x0>;
			};
		};

		fragment@25 {

			__overlay__ {
				vreg1-supply = <0x0>;
				vreg2-supply = <0x0>;
			};
		};

		fragment@26 {

			__overlay__ {
				sensor_1v8-supply = <0x0>;
				sensor_3v3-supply = <0x0>;
			};
		};

		fragment@27 {

			__overlay__ {

				slg51000@75 {
					dlg,cs-gpios = <0x0>;
				};
			};
		};

		fragment@3 {

			__overlay__ {

				btbcm {
					pinctrl-0 = <0x0 0x4 0x8>;
				};
			};
		};

		fragment@30 {

			__overlay__ {
				pinctrl-0 = <0x0>;
				pinctrl-1 = <0x0>;
				pinctrl-2 = <0x0>;
			};
		};

		fragment@31 {

			__overlay__ {
				pinctrl-0 = <0x0>;
				pinctrl-1 = <0x0>;
				pinctrl-2 = <0x0>;
			};
		};

		fragment@32 {

			__overlay__ {
				pinctrl-0 = <0x0>;
				pinctrl-1 = <0x0>;
				pinctrl-2 = <0x0>;
			};
		};

		fragment@4 {

			__overlay__ {

				bcm4775@0 {
					pinctrl-0 = <0x0 0x4 0x8 0xc>;
				};
			};
		};

		fragment@44 {

			__overlay__ {

				panel@0 {
					touch = <0x0>;
					vci-supply = <0x0>;
					vddi-supply = <0x0>;
				};
			};
		};

		fragment@48 {

			__overlay__ {

				st21nfc@08 {
					pinctrl-0 = <0x0 0x4>;
				};
			};
		};

		fragment@52 {

			__overlay__ {
				pinctrl-0 = <0x0 0x4>;

				touchscreen@0 {
					avdd-supply = <0x0>;
					pinctrl-0 = <0x0 0x4 0x8>;
					vdd-supply = <0x0>;
				};
			};
		};

		fragment@55 {

			__overlay__ {
				pinctrl-0 = <0x8>;

				gsc@0 {
					pinctrl-0 = <0x0>;
				};
			};
		};

		fragment@59 {

			__overlay__ {

				codec {
					sound-dai = <0x0 0x8>;
				};
			};
		};

		fragment@6 {

			__overlay__ {

				fusb307b@50 {
					conn = <0x0>;
					ls = <0x0>;
					pinctrl-0 = <0x0>;

					connector {

						port {

							endpoint@0 {
								remote-endpoint = <0x0>;
							};
						};
					};

					port {

						endpoint@0 {
							remote-endpoint = <0x0>;
						};
					};
				};

				max20339ovp@35 {
					max20339,irq-gpio = <0x0>;
				};

				max77759tcpc@25 {
					conn = <0x0>;
					in-switch-gpio = <0x0>;
					max20339,ovp = <0x0>;
					pinctrl-0 = <0x0>;

					connector {

						port {

							endpoint@0 {
								remote-endpoint = <0x0>;
							};
						};
					};

					port {

						endpoint@0 {
							remote-endpoint = <0x0>;
						};
					};
				};
			};
		};

		fragment@60 {

			__overlay__ {

				codec {
					sound-dai = <0x0 0x8>;
				};
			};
		};

		fragment@61 {

			__overlay__ {

				clks {

					sys {

						sys@cs35l41_l {
							comp = <0x0>;
						};

						sys@cs35l41_r {
							comp = <0x0>;
						};
					};
				};
			};
		};

		fragment@66 {

			__overlay__ {

				cs35l41@40 {
					VA-supply = <0x0>;
					pinctrl-0 = <0x0 0x4>;
				};

				cs35l41@41 {
					VA-supply = <0x0>;
					pinctrl-0 = <0x0 0x4>;
				};

				drv2624_haptics@5a {
					pinctrl-0 = <0x0>;
				};
			};
		};

		fragment@70 {

			__overlay__ {

				max77729pmic@0x66 {
					pinctrl-0 = <0x0>;
				};
			};
		};

		fragment@72 {

			__overlay__ {

				panel@0 {
					vddi-supply = <0x0>;
				};
			};
		};

		fragment@74 {

			__overlay__ {

				btn_therm {
					thermal-sensors = <0x0>;
				};

				cam_therm {
					thermal-sensors = <0x0>;
				};

				disp_therm {
					thermal-sensors = <0x0>;
				};

				gnss_tcxo_therm {
					thermal-sensors = <0x0>;
				};

				quiet_therm {
					thermal-sensors = <0x0>;
				};

				soc_therm {
					thermal-sensors = <0x0>;
				};

				ufs_stb_therm {
					thermal-sensors = <0x0>;
				};

				usb_pwr_therm {
					thermal-sensors = <0x0>;
				};
			};
		};

		fragment@75 {

			__overlay__ {

				battery_cycle {
					thermal-sensors = <0x0>;
				};

				ocp_cpu1 {
					thermal-sensors = <0x0>;
				};

				ocp_cpu2 {
					thermal-sensors = <0x0>;
				};

				ocp_gpu {
					thermal-sensors = <0x0>;
				};

				ocp_tpu {
					thermal-sensors = <0x0>;
				};

				pmic_120c {
					thermal-sensors = <0x0>;
				};

				pmic_140c {
					thermal-sensors = <0x0>;
				};

				pmic_overheat {
					thermal-sensors = <0x0>;
				};

				smpl_gm {
					thermal-sensors = <0x0>;
				};

				soc {
					thermal-sensors = <0x0>;
				};

				soft_ocp_cpu1 {
					thermal-sensors = <0x0>;
				};

				soft_ocp_cpu2 {
					thermal-sensors = <0x0>;
				};

				soft_ocp_gpu {
					thermal-sensors = <0x0>;
				};

				soft_ocp_tpu {
					thermal-sensors = <0x0>;
				};
			};
		};

		fragment@battery {

			__overlay__ {

				google,mitigation {
					google,main-power = <0x0>;
					google,power-supply = <0x0>;
					google,sub-power = <0x0>;
				};

				google_bms {
					nvmem = <0x0>;
				};
			};
		};

		fragment@lwiscamera {

			__overlay__ {

				actuator@0 {
					enable-gpios = <0x0>;
					regulators = <0x0 0x4>;
				};

				eeprom@0 {
					enable-gpios = <0x0 0xc>;
					regulators = <0x0>;
				};

				eeprom@1 {
					enable-gpios = <0x0>;
					regulators = <0x0 0x4 0x8 0xc>;
				};

				eeprom@2 {
					enable-gpios = <0x0>;
					regulators = <0x0>;
				};

				flash@0 {
					pinctrl-0 = <0x0>;
					pinctrl-1 = <0x0>;
				};

				sensor@0 {
					enable-gpios = <0x0>;
					regulators = <0x0 0x4 0x8 0xc 0x10>;
				};

				sensor@1 {
					enable-gpios = <0x0>;
					regulators = <0x0 0x4 0x8 0xc>;
				};

				sensor@2 {
					enable-gpios = <0x0>;
					regulators = <0x0>;
				};
			};
		};

		fragment@modemif {

			__overlay__ {

				cpif {
					pinctrl-0 = <0x0 0x4 0x8 0xc 0x10 0x14 0x18 0x1c>;
				};
			};
		};

		fragment@typec {

			__overlay__ {

				google,usbc_port_cooling_dev {
					extcon = <0x0>;
				};
			};
		};
	};

	__symbols__ {
		actuator0 = "/fragment@lwiscamera/__overlay__/actuator@0";
		ap_dtls_cs = "/fragment@54/__overlay__/ap-dtls-cs";
		ap_gsc_irq = "/fragment@53/__overlay__/ap_gsc_irq";
		bt_dev_wake = "/fragment@0/__overlay__/bt-dev-wake";
		bt_host_wake = "/fragment@1/__overlay__/bt-host-wake";
		bt_reg_on = "/fragment@0/__overlay__/bt-reg-on";
		btbcm = "/fragment@3/__overlay__/btbcm";
		cfg_wlanen = "/fragment@9/__overlay__/cfg_wlanen";
		ch1 = "/fragment@14/__overlay__/s2mpg10mfd@00/odpm/channels/channel@0";
		ch10 = "/fragment@15/__overlay__/s2mpg11mfd@00/odpm/channels/channel@1";
		ch11 = "/fragment@15/__overlay__/s2mpg11mfd@00/odpm/channels/channel@2";
		ch12 = "/fragment@15/__overlay__/s2mpg11mfd@00/odpm/channels/channel@3";
		ch13 = "/fragment@15/__overlay__/s2mpg11mfd@00/odpm/channels/channel@4";
		ch14 = "/fragment@15/__overlay__/s2mpg11mfd@00/odpm/channels/channel@5";
		ch15 = "/fragment@15/__overlay__/s2mpg11mfd@00/odpm/channels/channel@6";
		ch16 = "/fragment@15/__overlay__/s2mpg11mfd@00/odpm/channels/channel@7";
		ch2 = "/fragment@14/__overlay__/s2mpg10mfd@00/odpm/channels/channel@1";
		ch3 = "/fragment@14/__overlay__/s2mpg10mfd@00/odpm/channels/channel@2";
		ch4 = "/fragment@14/__overlay__/s2mpg10mfd@00/odpm/channels/channel@3";
		ch5 = "/fragment@14/__overlay__/s2mpg10mfd@00/odpm/channels/channel@4";
		ch6 = "/fragment@14/__overlay__/s2mpg10mfd@00/odpm/channels/channel@5";
		ch7 = "/fragment@14/__overlay__/s2mpg10mfd@00/odpm/channels/channel@6";
		ch8 = "/fragment@14/__overlay__/s2mpg10mfd@00/odpm/channels/channel@7";
		ch9 = "/fragment@15/__overlay__/s2mpg11mfd@00/odpm/channels/channel@0";
		conn = "/fragment@6/__overlay__/max77759tcpc@25/connector";
		cs35l41_l = "/fragment@66/__overlay__/cs35l41@40";
		cs35l41_l_irq = "/fragment@63/__overlay__/cs35l41-l-irq";
		cs35l41_l_rst = "/fragment@64/__overlay__/cs35l41-l-rst";
		cs35l41_r = "/fragment@66/__overlay__/cs35l41@41";
		cs35l41_r_irq = "/fragment@62/__overlay__/cs35l41-r-irq";
		cs35l41_r_rst = "/fragment@65/__overlay__/cs35l41-r-rst";
		eeprom0 = "/fragment@lwiscamera/__overlay__/eeprom@0";
		eeprom1 = "/fragment@lwiscamera/__overlay__/eeprom@1";
		eeprom2 = "/fragment@lwiscamera/__overlay__/eeprom@2";
		flash0 = "/fragment@lwiscamera/__overlay__/flash@0";
		flash_active = "/fragment@29/__overlay__/flash_active";
		flash_suspend = "/fragment@29/__overlay__/flash_suspend";
		fusb307b = "/fragment@6/__overlay__/fusb307b@50";
		google_battery = "/fragment@battery/__overlay__/google,battery";
		google_charger = "/fragment@battery/__overlay__/google,charger";
		google_cpm = "/fragment@battery/__overlay__/google,cpm";
		google_mitigation = "/fragment@battery/__overlay__/google,mitigation";
		gps_host_req = "/fragment@58/__overlay__/gps-host-req";
		gps_mcu_req = "/fragment@5/__overlay__/gps-mcu-req";
		gps_mcu_resp = "/fragment@57/__overlay__/gps-mcu-resp";
		gps_nstandby = "/fragment@5/__overlay__/gps-nstandby";
		gs101_tm1 = "/fragment@73/__overlay__/s2mpg11mfd@00/gs101_spmic_tm1";
		hapt_amp_rst = "/fragment@65/__overlay__/hapt-amp-rst";
		hapt_amp_trig = "/fragment@65/__overlay__/hapt-amp-trig";
		hsi2c2_bus = "/fragment@28/__overlay__/hsi2c2-bus";
		hsi2c2_bus_in = "/fragment@28/__overlay__/hsi2c2-bus-in";
		hsi2c3_bus = "/fragment@28/__overlay__/hsi2c3-bus";
		hsi2c3_bus_in = "/fragment@28/__overlay__/hsi2c3-bus-in";
		hsi2c4_bus = "/fragment@28/__overlay__/hsi2c4-bus";
		hsi2c4_bus_in = "/fragment@28/__overlay__/hsi2c4-bus-in";
		if_pmic_fg_irq = "/fragment@68/__overlay__/if-pmic-fg-irq";
		if_pmic_irq = "/fragment@69/__overlay__/if-pmic-irq";
		key_power = "/fragment@19/__overlay__/key-power";
		key_voldown = "/fragment@18/__overlay__/key-voldown";
		key_volup = "/fragment@18/__overlay__/key-volup";
		m_buck10_reg = "/fragment@14/__overlay__/s2mpg10mfd@00/regulators/BUCK10M";
		m_buck1_reg = "/fragment@14/__overlay__/s2mpg10mfd@00/regulators/BUCK1M";
		m_buck2_reg = "/fragment@14/__overlay__/s2mpg10mfd@00/regulators/BUCK2M";
		m_buck3_reg = "/fragment@14/__overlay__/s2mpg10mfd@00/regulators/BUCK3M";
		m_buck4_reg = "/fragment@14/__overlay__/s2mpg10mfd@00/regulators/BUCK4M";
		m_buck5_reg = "/fragment@14/__overlay__/s2mpg10mfd@00/regulators/BUCK5M";
		m_buck6_reg = "/fragment@14/__overlay__/s2mpg10mfd@00/regulators/BUCK6M";
		m_buck7_reg = "/fragment@14/__overlay__/s2mpg10mfd@00/regulators/BUCK7M";
		m_buck8_reg = "/fragment@14/__overlay__/s2mpg10mfd@00/regulators/BUCK8M";
		m_buck9_reg = "/fragment@14/__overlay__/s2mpg10mfd@00/regulators/BUCK9M";
		m_ext1_rail = "/fragment@14/__overlay__/s2mpg10mfd@00/odpm/rails/VSEN_C1";
		m_ext2_rail = "/fragment@14/__overlay__/s2mpg10mfd@00/odpm/rails/VSEN_C2";
		m_ext3_rail = "/fragment@14/__overlay__/s2mpg10mfd@00/odpm/rails/VSEN_C3";
		m_ldo10_reg = "/fragment@14/__overlay__/s2mpg10mfd@00/regulators/LDO10M";
		m_ldo11_reg = "/fragment@14/__overlay__/s2mpg10mfd@00/regulators/LDO11M";
		m_ldo12_reg = "/fragment@14/__overlay__/s2mpg10mfd@00/regulators/LDO12M";
		m_ldo13_reg = "/fragment@14/__overlay__/s2mpg10mfd@00/regulators/LDO13M";
		m_ldo14_reg = "/fragment@14/__overlay__/s2mpg10mfd@00/regulators/LDO14M";
		m_ldo15_reg = "/fragment@14/__overlay__/s2mpg10mfd@00/regulators/LDO15M";
		m_ldo16_reg = "/fragment@14/__overlay__/s2mpg10mfd@00/regulators/LDO16M";
		m_ldo17_reg = "/fragment@14/__overlay__/s2mpg10mfd@00/regulators/LDO17M";
		m_ldo18_reg = "/fragment@14/__overlay__/s2mpg10mfd@00/regulators/LDO18M";
		m_ldo19_reg = "/fragment@14/__overlay__/s2mpg10mfd@00/regulators/LDO19M";
		m_ldo1_reg = "/fragment@14/__overlay__/s2mpg10mfd@00/regulators/LDO1M";
		m_ldo20_reg = "/fragment@14/__overlay__/s2mpg10mfd@00/regulators/LDO20M";
		m_ldo21_reg = "/fragment@14/__overlay__/s2mpg10mfd@00/regulators/LDO21M";
		m_ldo22_reg = "/fragment@14/__overlay__/s2mpg10mfd@00/regulators/LDO22M";
		m_ldo23_reg = "/fragment@14/__overlay__/s2mpg10mfd@00/regulators/LDO23M";
		m_ldo24_reg = "/fragment@14/__overlay__/s2mpg10mfd@00/regulators/LDO24M";
		m_ldo25_reg = "/fragment@14/__overlay__/s2mpg10mfd@00/regulators/LDO25M";
		m_ldo26_reg = "/fragment@14/__overlay__/s2mpg10mfd@00/regulators/LDO26M";
		m_ldo27_reg = "/fragment@14/__overlay__/s2mpg10mfd@00/regulators/LDO27M";
		m_ldo28_reg = "/fragment@14/__overlay__/s2mpg10mfd@00/regulators/LDO28M";
		m_ldo29_reg = "/fragment@14/__overlay__/s2mpg10mfd@00/regulators/LDO29M";
		m_ldo2_reg = "/fragment@14/__overlay__/s2mpg10mfd@00/regulators/LDO2M";
		m_ldo30_reg = "/fragment@14/__overlay__/s2mpg10mfd@00/regulators/LDO30M";
		m_ldo31_reg = "/fragment@14/__overlay__/s2mpg10mfd@00/regulators/LDO31M";
		m_ldo3_reg = "/fragment@14/__overlay__/s2mpg10mfd@00/regulators/LDO3M";
		m_ldo4_reg = "/fragment@14/__overlay__/s2mpg10mfd@00/regulators/LDO4M";
		m_ldo5_reg = "/fragment@14/__overlay__/s2mpg10mfd@00/regulators/LDO5M";
		m_ldo6_reg = "/fragment@14/__overlay__/s2mpg10mfd@00/regulators/LDO6M";
		m_ldo7_reg = "/fragment@14/__overlay__/s2mpg10mfd@00/regulators/LDO7M";
		m_ldo8_reg = "/fragment@14/__overlay__/s2mpg10mfd@00/regulators/LDO8M";
		m_ldo9_reg = "/fragment@14/__overlay__/s2mpg10mfd@00/regulators/LDO9M";
		m_pmic_irq = "/fragment@13/__overlay__/m-pmic-irq";
		max20339_gpio = "/fragment@6/__overlay__/max20339ovp@35/max20339_gpio";
		max20339_ovp = "/fragment@6/__overlay__/max20339ovp@35";
		max77729_fg = "/fragment@70/__overlay__/max77729fg@0x36";
		max77729_pmic = "/fragment@70/__overlay__/max77729pmic@0x66";
		max77729_uic = "/fragment@70/__overlay__/max77729uic@0x25";
		max77759_tcpc_gpio = "/fragment@6/__overlay__/max77759tcpc@25/max77759_tcpc_gpio";
		max77759tcpc = "/fragment@6/__overlay__/max77759tcpc@25";
		max777x9_gpio = "/fragment@70/__overlay__/max77729pmic@0x66/max777x9_gpio";
		mux_notification_sink = "/fragment@6/__overlay__/fusb307b@50/port/endpoint@0";
		mux_notification_snk = "/fragment@6/__overlay__/max77759tcpc@25/port/endpoint@0";
		mux_notification_source = "/fragment@6/__overlay__/fusb307b@50/connector/port/endpoint@0";
		mux_notification_src = "/fragment@6/__overlay__/max77759tcpc@25/connector/port/endpoint@0";
		nfc_pidle = "/fragment@46/__overlay__/nfc-pidle";
		nfc_rst = "/fragment@46/__overlay__/nfc-rst";
		ocp_cpu1 = "/fragment@75/__overlay__/ocp_cpu1/trips/ocp-cpu1";
		ocp_cpu2 = "/fragment@75/__overlay__/ocp_cpu2/trips/ocp-cpu2";
		ocp_gpu = "/fragment@75/__overlay__/ocp_gpu/trips/ocp-gpu";
		ocp_tpu = "/fragment@75/__overlay__/ocp_tpu/trips/ocp-tpu";
		pack_bee = "/fragment@35/__overlay__/m24c08@50";
		pmic_120c = "/fragment@75/__overlay__/pmic_120c/trips/pmic-120c";
		pmic_140c = "/fragment@75/__overlay__/pmic_140c/trips/pmic-140c";
		pmic_overheat = "/fragment@75/__overlay__/pmic_overheat/trips/pmic-overheat";
		s2mpg10_gpio = "/fragment@14/__overlay__/s2mpg10mfd@00/s2mpg10_gpio";
		s2mpg10_pinctrl = "/fragment@14/__overlay__/s2mpg10mfd@00/s2mpg10_pinctrl";
		s2mpg10mfd = "/fragment@14/__overlay__/s2mpg10mfd@00";
		s2mpg11_gpio = "/fragment@15/__overlay__/s2mpg11mfd@00/s2mpg11_gpio";
		s2mpg11_pinctrl = "/fragment@15/__overlay__/s2mpg11mfd@00/s2mpg11_pinctrl";
		s2mpg11mfd = "/fragment@15/__overlay__/s2mpg11mfd@00";
		s5100_ap2cp_cp_nreset_n = "/fragment@43/__overlay__/s5100_ap2cp_cp_nreset_n";
		s5100_ap2cp_cp_pwr_on = "/fragment@43/__overlay__/s5100_ap2cp_cp_pwr_on";
		s5100_ap2cp_dump_noti = "/fragment@43/__overlay__/s5100_ap2cp_dump_noti";
		s5100_ap2cp_pda_active = "/fragment@43/__overlay__/s5100_ap2cp_pda_active";
		s5100_ap2cp_wakeup = "/fragment@43/__overlay__/s5100_ap2cp_wakeup";
		s5100_cp2ap_cp_ps_hold = "/fragment@41/__overlay__/s5100_cp2ap_cp_ps_hold";
		s5100_cp2ap_phone_active = "/fragment@71/__overlay__/s5100_cp2ap_phone_active";
		s5100_cp2ap_wakeup = "/fragment@42/__overlay__/s5100_cp2ap_wakeup";
		s_buck10_reg = "/fragment@15/__overlay__/s2mpg11mfd@00/regulators/BUCK10S";
		s_buck1_reg = "/fragment@15/__overlay__/s2mpg11mfd@00/regulators/BUCK1S";
		s_buck2_reg = "/fragment@15/__overlay__/s2mpg11mfd@00/regulators/BUCK2S";
		s_buck3_reg = "/fragment@15/__overlay__/s2mpg11mfd@00/regulators/BUCK3S";
		s_buck4_reg = "/fragment@15/__overlay__/s2mpg11mfd@00/regulators/BUCK4S";
		s_buck5_reg = "/fragment@15/__overlay__/s2mpg11mfd@00/regulators/BUCK5S";
		s_buck6_reg = "/fragment@15/__overlay__/s2mpg11mfd@00/regulators/BUCK6S";
		s_buck7_reg = "/fragment@15/__overlay__/s2mpg11mfd@00/regulators/BUCK7S";
		s_buck8_reg = "/fragment@15/__overlay__/s2mpg11mfd@00/regulators/BUCK8S";
		s_buck9_reg = "/fragment@15/__overlay__/s2mpg11mfd@00/regulators/BUCK9S";
		s_bucka_reg = "/fragment@15/__overlay__/s2mpg11mfd@00/regulators/BUCKA";
		s_buckboost_reg = "/fragment@15/__overlay__/s2mpg11mfd@00/regulators/BUCKBOOST";
		s_buckd_reg = "/fragment@15/__overlay__/s2mpg11mfd@00/regulators/BUCKD";
		s_ext4_rail = "/fragment@15/__overlay__/s2mpg11mfd@00/odpm/rails/VSEN_C4";
		s_ext5_rail = "/fragment@15/__overlay__/s2mpg11mfd@00/odpm/rails/VSEN_C5";
		s_ext6_rail = "/fragment@15/__overlay__/s2mpg11mfd@00/odpm/rails/VSEN_C6";
		s_ldo10_reg = "/fragment@15/__overlay__/s2mpg11mfd@00/regulators/LDO10S";
		s_ldo11_reg = "/fragment@15/__overlay__/s2mpg11mfd@00/regulators/LDO11S";
		s_ldo12_reg = "/fragment@15/__overlay__/s2mpg11mfd@00/regulators/LDO12S";
		s_ldo13_reg = "/fragment@15/__overlay__/s2mpg11mfd@00/regulators/LDO13S";
		s_ldo14_reg = "/fragment@15/__overlay__/s2mpg11mfd@00/regulators/LDO14S";
		s_ldo15_reg = "/fragment@15/__overlay__/s2mpg11mfd@00/regulators/LDO15S";
		s_ldo1_reg = "/fragment@15/__overlay__/s2mpg11mfd@00/regulators/LDO1S";
		s_ldo2_reg = "/fragment@15/__overlay__/s2mpg11mfd@00/regulators/LDO2S";
		s_ldo3_reg = "/fragment@15/__overlay__/s2mpg11mfd@00/regulators/LDO3S";
		s_ldo4_reg = "/fragment@15/__overlay__/s2mpg11mfd@00/regulators/LDO4S";
		s_ldo5_reg = "/fragment@15/__overlay__/s2mpg11mfd@00/regulators/LDO5S";
		s_ldo6_reg = "/fragment@15/__overlay__/s2mpg11mfd@00/regulators/LDO6S";
		s_ldo7_reg = "/fragment@15/__overlay__/s2mpg11mfd@00/regulators/LDO7S";
		s_ldo8_reg = "/fragment@15/__overlay__/s2mpg11mfd@00/regulators/LDO8S";
		s_ldo9_reg = "/fragment@15/__overlay__/s2mpg11mfd@00/regulators/LDO9S";
		s_pmic_irq = "/fragment@13/__overlay__/s-pmic-irq";
		sec_ts_irq = "/fragment@50/__overlay__/sec_ts-irq";
		sec_ts_reset = "/fragment@51/__overlay__/sec_ts-reset";
		sec_ts_switch = "/fragment@51/__overlay__/sec_ts-switch";
		sensor0 = "/fragment@lwiscamera/__overlay__/sensor@0";
		sensor1 = "/fragment@lwiscamera/__overlay__/sensor@1";
		sensor2 = "/fragment@lwiscamera/__overlay__/sensor@2";
		slg51000 = "/fragment@27/__overlay__/slg51000@75";
		slg51000_ldo1 = "/fragment@27/__overlay__/slg51000@75/regulators/ldo1";
		slg51000_ldo2 = "/fragment@27/__overlay__/slg51000@75/regulators/ldo2";
		slg51000_ldo3 = "/fragment@27/__overlay__/slg51000@75/regulators/ldo3";
		slg51000_ldo4 = "/fragment@27/__overlay__/slg51000@75/regulators/ldo4";
		slg51000_ldo5 = "/fragment@27/__overlay__/slg51000@75/regulators/ldo5";
		slg51000_ldo6 = "/fragment@27/__overlay__/slg51000@75/regulators/ldo6";
		slg51000_ldo7 = "/fragment@27/__overlay__/slg51000@75/regulators/ldo7";
		slg_pld = "/fragment@6/__overlay__/slg46826@8";
		smpl = "/fragment@75/__overlay__/smpl_gm/trips/smpl_0";
		smpl_warn = "/fragment@13/__overlay__/smpl-warn";
		soc_trip = "/fragment@75/__overlay__/soc/trips/soc-trip";
		soft_ocp_cpu1 = "/fragment@75/__overlay__/soft_ocp_cpu1/trips/soft-ocp-cpu1";
		soft_ocp_cpu2 = "/fragment@75/__overlay__/soft_ocp_cpu2/trips/soft-ocp-cpu2";
		soft_ocp_gpu = "/fragment@75/__overlay__/soft_ocp_gpu/trips/soft-ocp-gpu";
		soft_ocp_tpu = "/fragment@75/__overlay__/soft_ocp_tpu/trips/soft-ocp-tpu";
		spi11_bus = "/fragment@51/__overlay__/spi11-bus";
		spi11_cs = "/fragment@51/__overlay__/spi11-cs";
		spi11_cs_func = "/fragment@51/__overlay__/spi11-cs-func";
		spitouch = "/fragment@52/__overlay__/touchscreen@0";
		trip_config0 = "/fragment@74/__overlay__/soc_therm/trips/trip-config0";
		trip_config1 = "/fragment@74/__overlay__/quiet_therm/trips/trip-config1";
		trip_config2 = "/fragment@74/__overlay__/usb_pwr_therm/trips/trip-config2";
		trip_config3 = "/fragment@74/__overlay__/cam_therm/trips/trip-config3";
		trip_config4 = "/fragment@74/__overlay__/btn_therm/trips/trip-config4";
		trip_config5 = "/fragment@74/__overlay__/disp_therm/trips/trip-config5";
		trip_config6 = "/fragment@74/__overlay__/ufs_stb_therm/trips/trip-config6";
		trip_config7 = "/fragment@74/__overlay__/gnss_tcxo_therm/trips/trip-config7";
		usb_con = "/fragment@6/__overlay__/fusb307b@50/connector";
		usb_hs_tune = "/fragment@22/__overlay__/hs_tune";
		usb_pd_irq = "/fragment@8/__overlay__/usb-pd-irq";
		usb_ss_tune = "/fragment@22/__overlay__/ss_tune";
		usbdrd_dwc3 = "/fragment@21/__overlay__/dwc3";
		wlan_dev_wake = "/fragment@11/__overlay__/wlan_dev_wake";
		wlan_host_wake = "/fragment@10/__overlay__/wlan_host_wake";
	};

	fragment@0 {
		target = <0xffffffff>;

		__overlay__ {

			bt-dev-wake {
				phandle = <0x2>;
				samsung,pin-con-pdn = <0x3>;
				samsung,pin-drv = <0x0>;
				samsung,pin-function = <0x1>;
				samsung,pin-pud = <0x0>;
				samsung,pin-pud-pdn = <0x1>;
				samsung,pins = "gpp14-3";
			};

			bt-reg-on {
				phandle = <0x1>;
				samsung,pin-con-pdn = <0x3>;
				samsung,pin-drv = <0x0>;
				samsung,pin-function = <0x1>;
				samsung,pin-pud = <0x0>;
				samsung,pin-pud-pdn = <0x0>;
				samsung,pins = "gpp16-2";
			};
		};
	};

	fragment@1 {
		target = <0xffffffff>;

		__overlay__ {

			bt-host-wake {
				phandle = <0x3>;
				samsung,pin-con-pdn = <0x3>;
				samsung,pin-drv = <0x0>;
				samsung,pin-function = <0xf>;
				samsung,pin-pud = <0x1>;
				samsung,pin-pud-pdn = <0x1>;
				samsung,pins = "gpa6-6";
			};
		};
	};

	fragment@10 {
		target = <0xffffffff>;

		__overlay__ {

			wlan_host_wake {
				phandle = <0x15>;
				samsung,pin-con-pdn = <0x3>;
				samsung,pin-drv = <0x0>;
				samsung,pin-function = <0xf>;
				samsung,pin-pud = <0x1>;
				samsung,pin-pud-pdn = <0x1>;
				samsung,pins = "gpa7-0";
			};
		};
	};

	fragment@11 {
		target = <0xffffffff>;

		__overlay__ {

			wlan_dev_wake {
				phandle = <0x16>;
				samsung,pin-con-pdn = <0x3>;
				samsung,pin-drv = <0x0>;
				samsung,pin-function = <0x0>;
				samsung,pin-pud = <0x1>;
				samsung,pin-pud-pdn = <0x1>;
				samsung,pins = "gph2-5";
			};
		};
	};

	fragment@12 {
		target = <0xffffffff>;

		__overlay__ {
			pinctrl-0 = <0xffffffff 0xffffffff 0x14 0x15 0x16>;

			wlan {
				ch-num = <0x1>;
				compatible = "android,bcmdhd_wlan";
				status = "okay";
				wl_dev_wake = <0xffffffff 0x5 0x1>;
				wl_host_wake = <0xffffffff 0x0 0x1>;
				wl_reg_on = <0xffffffff 0x2 0x1>;
			};
		};
	};

	fragment@13 {
		target = <0xffffffff>;

		__overlay__ {

			m-pmic-irq {
				phandle = <0x17>;
				samsung,pin-pud = <0x0>;
				samsung,pins = "gpa0-6";
			};

			s-pmic-irq {
				phandle = <0x1a>;
				samsung,pin-pud = <0x0>;
				samsung,pins = "gpa0-7";
			};

			smpl-warn {
				phandle = <0x18>;
				samsung,pin-drv = <0x0>;
				samsung,pin-function = <0xf>;
				samsung,pin-pud = <0x0>;
				samsung,pins = "gpa5-0";
			};
		};
	};

	fragment@14 {
		target = <0xffffffff>;

		__overlay__ {
			#address-cells = <0x1>;
			#size-cells = <0x0>;
			status = "okay";

			s2mpg10mfd@00 {
				#thermal-sensor-cells = <0x1>;
				acpm-ipc-channel = <0x2>;
				acpm-speedy-channel = <0x0>;
				b10_ocp_warn_cnt = <0x0>;
				b10_ocp_warn_dvs_mask = <0x0>;
				b10_ocp_warn_en = <0x1>;
				b10_ocp_warn_lvl = <0xd>;
				b10_soft_ocp_warn_cnt = <0x0>;
				b10_soft_ocp_warn_dvs_mask = <0x0>;
				b10_soft_ocp_warn_en = <0x1>;
				b10_soft_ocp_warn_lvl = <0x14>;
				b2_ocp_warn_cnt = <0x0>;
				b2_ocp_warn_dvs_mask = <0x0>;
				b2_ocp_warn_en = <0x1>;
				b2_ocp_warn_lvl = <0x8>;
				b2_soft_ocp_warn_cnt = <0x0>;
				b2_soft_ocp_warn_dvs_mask = <0x0>;
				b2_soft_ocp_warn_en = <0x1>;
				b2_soft_ocp_warn_lvl = <0x8>;
				b3_ocp_warn_cnt = <0x0>;
				b3_ocp_warn_dvs_mask = <0x0>;
				b3_ocp_warn_en = <0x1>;
				b3_ocp_warn_lvl = <0xd>;
				b3_soft_ocp_warn_cnt = <0x0>;
				b3_soft_ocp_warn_dvs_mask = <0x0>;
				b3_soft_ocp_warn_en = <0x1>;
				b3_soft_ocp_warn_lvl = <0xd>;
				buck_ocp_ctrl1 = <0xbb>;
				buck_ocp_ctrl2 = <0xbb>;
				buck_ocp_ctrl3 = <0xbb>;
				buck_ocp_ctrl4 = <0xbb>;
				buck_ocp_ctrl5 = <0xbb>;
				check_jigon = <0x0>;
				coldrst_en = "disabled";
				coldrst_timer_val = <0x3>;
				compatible = "samsung,s2mpg10mfd";
				dev-name = "s2mpg10mfd";
				gpios = <0xffffffff 0x0 0x0 0xffffffff 0x1 0x0 0xffffffff 0x2 0x0 0xffffffff 0x3 0x0 0xffffffff 0x4 0x0 0xffffffff 0x1 0x0 0xffffffff 0x3 0x0>;
				init_time,hour = <0xc>;
				init_time,mday = <0x1>;
				init_time,min = <0x0>;
				init_time,mon = <0x0>;
				init_time,sec = <0x0>;
				init_time,wday = <0x3>;
				init_time,year = <0x78>;
				interrupt-parent = <0xffffffff>;
				interrupts = <0x1 0x0 0x0 0x1 0x0 0x1 0x1 0x0 0x2 0x1 0x0 0x3 0x1 0x0 0x4 0x1 0x0 0x5 0x1 0x0 0x6>;
				phandle = <0x1c>;
				pinctrl-0 = <0x17 0x18>;
				pinctrl-names = "default";
				reg = <0x1f>;
				s2mpg10,irq-gpio = <0xffffffff 0x6 0x0>;
				s2mpg10,wakeup = "enabled";
				smpl_en = "disabled";
				smpl_timer_val = <0x4>;
				smpl_warn_en = <0x1>;
				smpl_warn_hys = <0x1>;
				smpl_warn_vth = <0x3>;
				sub_smpl_en = "disabled";
				wtsr_en = "enabled";
				wtsr_timer_val = <0x3>;

				odpm {
					chip-name = "S2MPG10";
					max-refresh-time-ms = <0xdbba0>;
					sample-rate-external-uhz = <0x1d19574>;
					sample-rate-uhz = <0x7735940>;

					channels {

						channel@0 {
							channel_enabled;
							phandle = <0x80>;
							rail-name = "BUCK10M";
						};

						channel@1 {
							channel_enabled;
							phandle = <0x81>;
							rail-name = "VSEN_C2";
						};

						channel@2 {
							channel_enabled;
							phandle = <0x82>;
							rail-name = "VSEN_C3";
						};

						channel@3 {
							channel_enabled;
							phandle = <0x83>;
							rail-name = "BUCK2M";
						};

						channel@4 {
							channel_enabled;
							phandle = <0x84>;
							rail-name = "BUCK3M";
						};

						channel@5 {
							channel_enabled;
							phandle = <0x85>;
							rail-name = "BUCK4M";
						};

						channel@6 {
							channel_enabled;
							phandle = <0x86>;
							rail-name = "BUCK5M";
						};

						channel@7 {
							channel_enabled;
							phandle = <0x87>;
							rail-name = "BUCK1M";
						};
					};

					rails {
						use-regulators-as-rails;

						VSEN_C1 {
							channel-en-index = <0x1>;
							channel-mux-selection = <0x5c>;
							external_rail;
							phandle = <0x88>;
							schematic-name = "VSEN_C1_NC";
							shunt-res-uohms = <0x2710>;
							subsys-name = "Spare";
						};

						VSEN_C2 {
							channel-en-index = <0x2>;
							channel-mux-selection = <0x5d>;
							external_rail;
							phandle = <0x89>;
							schematic-name = "VSYS_PWR_MODEM";
							shunt-res-uohms = <0x1388>;
							subsys-name = "Modem";
						};

						VSEN_C3 {
							channel-en-index = <0x4>;
							channel-mux-selection = <0x5e>;
							external_rail;
							phandle = <0x8a>;
							schematic-name = "VSYS_PWR_RFFE";
							shunt-res-uohms = <0x1388>;
							subsys-name = "Cellular";
						};
					};
				};

				regulators {

					BUCK10M {
						buck_rail;
						channel-en-byte-offset = <0x1>;
						channel-en-index = <0x2>;
						channel-mux-selection = <0xa>;
						odpm_disable_in_sleep;
						phandle = <0x6d>;
						regulator-always-on;
						regulator-initial-mode = <0x1>;
						regulator-max-microvolt = <0x13d620>;
						regulator-min-microvolt = <0x6ddd0>;
						regulator-name = "S2MPG10_BUCK10";
						schematic-name = "S10M_VDD_TPU";
						subsys-name = "TPU";
					};

					BUCK1M {
						buck_rail;
						channel-en-byte-offset = <0x0>;
						channel-en-index = <0x1>;
						channel-mux-selection = <0x1>;
						phandle = <0x64>;
						regulator-always-on;
						regulator-initial-mode = <0x1>;
						regulator-max-microvolt = <0x13d620>;
						regulator-min-microvolt = <0x6ddd0>;
						regulator-name = "S2MPG10_BUCK1";
						schematic-name = "S1M_VDD_MIF";
						subsys-name = "MIF";
					};

					BUCK2M {
						buck_rail;
						channel-en-byte-offset = <0x0>;
						channel-en-index = <0x2>;
						channel-mux-selection = <0x2>;
						odpm_disable_in_sleep;
						phandle = <0x65>;
						regulator-always-on;
						regulator-initial-mode = <0x1>;
						regulator-max-microvolt = <0x13d620>;
						regulator-min-microvolt = <0x6ddd0>;
						regulator-name = "S2MPG10_BUCK2";
						schematic-name = "S2M_VDD_CPUCL2";
						subsys-name = "CPU(BIG)";
					};

					BUCK3M {
						buck_rail;
						channel-en-byte-offset = <0x0>;
						channel-en-index = <0x4>;
						channel-mux-selection = <0x3>;
						odpm_disable_in_sleep;
						phandle = <0x66>;
						regulator-always-on;
						regulator-initial-mode = <0x1>;
						regulator-max-microvolt = <0x13d620>;
						regulator-min-microvolt = <0x6ddd0>;
						regulator-name = "S2MPG10_BUCK3";
						schematic-name = "S3M_VDD_CPUCL1";
						subsys-name = "CPU(MID)";
					};

					BUCK4M {
						buck_rail;
						channel-en-byte-offset = <0x0>;
						channel-en-index = <0x8>;
						channel-mux-selection = <0x4>;
						odpm_disable_in_sleep;
						phandle = <0x67>;
						regulator-always-on;
						regulator-initial-mode = <0x1>;
						regulator-max-microvolt = <0x13d620>;
						regulator-min-microvolt = <0x6ddd0>;
						regulator-name = "S2MPG10_BUCK4";
						schematic-name = "S4M_VDD_CPUCL0";
						subsys-name = "CPU(LITTLE)";
					};

					BUCK5M {
						buck_rail;
						channel-en-byte-offset = <0x0>;
						channel-en-index = <0x10>;
						channel-mux-selection = <0x5>;
						odpm_disable_in_sleep;
						phandle = <0x68>;
						regulator-always-on;
						regulator-initial-mode = <0x1>;
						regulator-max-microvolt = <0x13d620>;
						regulator-min-microvolt = <0x6ddd0>;
						regulator-name = "S2MPG10_BUCK5";
						schematic-name = "S5M_VDD_INT";
						subsys-name = "INT";
					};

					BUCK6M {
						buck_rail;
						channel-en-byte-offset = <0x0>;
						channel-en-index = <0x20>;
						channel-mux-selection = <0x6>;
						odpm_disable_in_sleep;
						phandle = <0x69>;
						regulator-always-on;
						regulator-initial-mode = <0x1>;
						regulator-max-microvolt = <0x13d620>;
						regulator-min-microvolt = <0x6ddd0>;
						regulator-name = "S2MPG10_BUCK6";
						schematic-name = "S6M_VDD_CPUCL2_M";
						subsys-name = "CPU(BIG)";
					};

					BUCK7M {
						buck_rail;
						channel-en-byte-offset = <0x0>;
						channel-en-index = <0x40>;
						channel-mux-selection = <0x7>;
						odpm_disable_in_sleep;
						phandle = <0x6a>;
						regulator-always-on;
						regulator-initial-mode = <0x1>;
						regulator-max-microvolt = <0x13d620>;
						regulator-min-microvolt = <0x6ddd0>;
						regulator-name = "S2MPG10_BUCK7";
						schematic-name = "S7M_VDD_INT_M";
						subsys-name = "INT";
					};

					BUCK8M {
						buck_rail;
						channel-en-byte-offset = <0x0>;
						channel-en-index = <0x80>;
						channel-mux-selection = <0x8>;
						phandle = <0x6b>;
						regulator-always-on;
						regulator-initial-mode = <0x3>;
						regulator-max-microvolt = <0x13d620>;
						regulator-min-microvolt = <0x6ddd0>;
						regulator-name = "S2MPG10_BUCK8";
						schematic-name = "S8M_LLDO2";
						subsys-name = "LDO";
					};

					BUCK9M {
						buck_rail;
						channel-en-byte-offset = <0x1>;
						channel-en-index = <0x1>;
						channel-mux-selection = <0x9>;
						phandle = <0x6c>;
						regulator-always-on;
						regulator-initial-mode = <0x3>;
						regulator-max-microvolt = <0x13d620>;
						regulator-min-microvolt = <0x6ddd0>;
						regulator-name = "S2MPG10_BUCK9";
						schematic-name = "S9M_LLDO3";
						subsys-name = "LDO";
					};

					LDO10M {
						channel-mux-selection = <0x2a>;
						phandle = <0x26>;
						regulator-initial-mode = <0x3>;
						regulator-max-microvolt = <0x331df0>;
						regulator-min-microvolt = <0x1b7740>;
						regulator-name = "S2MPG10_LDO10";
						schematic-name = "L10M_USB";
						subsys-name = "USB";
					};

					LDO11M {
						channel-mux-selection = <0x2b>;
						phandle = <0x74>;
						regulator-always-on;
						regulator-initial-mode = <0x1>;
						regulator-max-microvolt = <0x13d620>;
						regulator-min-microvolt = <0xaae60>;
						regulator-name = "S2MPG10_LDO11";
						schematic-name = "L11M_VDD_CPUCL1_M";
						subsys-name = "CPU(MID)";
					};

					LDO12M {
						channel-mux-selection = <0x2c>;
						phandle = <0x75>;
						regulator-always-on;
						regulator-initial-mode = <0x1>;
						regulator-max-microvolt = <0x13d620>;
						regulator-min-microvolt = <0xaae60>;
						regulator-name = "S2MPG10_LDO12";
						schematic-name = "L12M_VDD_CPUCL0_M";
						subsys-name = "CPU(LITTLE)";
					};

					LDO13M {
						channel-mux-selection = <0x2d>;
						phandle = <0x76>;
						regulator-always-on;
						regulator-initial-mode = <0x1>;
						regulator-max-microvolt = <0xe7ef0>;
						regulator-min-microvolt = <0x6ddd0>;
						regulator-name = "S2MPG10_LDO13";
						schematic-name = "L13M_VDD_TPU_M";
						subsys-name = "TPU";
					};

					LDO14M {
						channel-mux-selection = <0x2e>;
						phandle = <0x77>;
						regulator-always-on;
						regulator-initial-mode = <0x1>;
						regulator-max-microvolt = <0x1dc130>;
						regulator-min-microvolt = <0x186a00>;
						regulator-name = "S2MPG10_LDO14";
						schematic-name = "L14M_AVDD_TCXO";
						subsys-name = "PLL";
					};

					LDO15M {
						channel-mux-selection = <0x2f>;
						phandle = <0x78>;
						regulator-always-on;
						regulator-initial-mode = <0x3>;
						regulator-max-microvolt = <0xe7ef0>;
						regulator-min-microvolt = <0x6ddd0>;
						regulator-name = "S2MPG10_LDO15";
						schematic-name = "L15M_VDD_SLC_M";
						subsys-name = "SLC";
					};

					LDO16M {
						channel-mux-selection = <0x30>;
						phandle = <0x27>;
						regulator-always-on;
						regulator-initial-mode = <0x1>;
						regulator-max-microvolt = <0x13d620>;
						regulator-min-microvolt = <0xb1008>;
						regulator-name = "S2MPG10_LDO16";
						schematic-name = "L16M_PCIE0";
						subsys-name = "PCIE";
					};

					LDO17M {
						channel-mux-selection = <0x31>;
						phandle = <0x29>;
						regulator-always-on;
						regulator-initial-mode = <0x1>;
						regulator-max-microvolt = <0x13d620>;
						regulator-min-microvolt = <0xb1008>;
						regulator-name = "S2MPG10_LDO17";
						schematic-name = "L17M_PCIE1";
						subsys-name = "PCIE";
					};

					LDO18M {
						channel-mux-selection = <0x32>;
						phandle = <0x28>;
						regulator-always-on;
						regulator-initial-mode = <0x1>;
						regulator-max-microvolt = <0x1dc130>;
						regulator-min-microvolt = <0x186a00>;
						regulator-name = "S2MPG10_LDO18";
						schematic-name = "L18M_PCIE0";
						subsys-name = "PCIE";
					};

					LDO19M {
						channel-mux-selection = <0x33>;
						phandle = <0x2a>;
						regulator-always-on;
						regulator-initial-mode = <0x1>;
						regulator-max-microvolt = <0x1dc130>;
						regulator-min-microvolt = <0x186a00>;
						regulator-name = "S2MPG10_LDO19";
						schematic-name = "L19M_PCIE1";
						subsys-name = "PCIE";
					};

					LDO1M {
						channel-mux-selection = <0x21>;
						phandle = <0x6e>;
						regulator-always-on;
						regulator-initial-mode = <0x3>;
						regulator-max-microvolt = <0x13d620>;
						regulator-min-microvolt = <0xaae60>;
						regulator-name = "S2MPG10_LDO1";
						schematic-name = "L1M_ALIVE";
						subsys-name = "Alive";
					};

					LDO20M {
						channel-mux-selection = <0x34>;
						phandle = <0x79>;
						regulator-always-on;
						regulator-initial-mode = <0x1>;
						regulator-max-microvolt = <0x1dc130>;
						regulator-min-microvolt = <0x186a00>;
						regulator-name = "S2MPG10_LDO20";
						schematic-name = "L20M_DMICS";
						subsys-name = "DMIC";
					};

					LDO21M {
						channel-mux-selection = <0x35>;
						phandle = <0x7a>;
						regulator-always-on;
						regulator-initial-mode = <0x3>;
						regulator-max-microvolt = <0x325aa0>;
						regulator-min-microvolt = <0x2625a0>;
						regulator-name = "S2MPG10_LDO21";
						schematic-name = "L21M_DTLS";
						subsys-name = "DTLS";
					};

					LDO22M {
						channel-mux-selection = <0x36>;
						phandle = <0x48>;
						regulator-initial-mode = <0x3>;
						regulator-max-microvolt = <0x325aa0>;
						regulator-min-microvolt = <0x2625a0>;
						regulator-name = "S2MPG10_LDO22";
						schematic-name = "L22M_DISP_VCI";
						subsys-name = "Display";
					};

					LDO23M {
						channel-mux-selection = <0x37>;
						phandle = <0x7b>;
						regulator-always-on;
						regulator-initial-mode = <0x3>;
						regulator-max-microvolt = <0x1dc130>;
						regulator-min-microvolt = <0x186a00>;
						regulator-name = "S2MPG10_LDO23";
						schematic-name = "L23M_DISP_VDDI";
						subsys-name = "Display";
					};

					LDO24M {
						channel-mux-selection = <0x38>;
						phandle = <0x7c>;
						regulator-max-microvolt = <0x13d620>;
						regulator-min-microvolt = <0xb1008>;
						regulator-name = "S2MPG10_LDO24";
						schematic-name = "L24M_UNUSED";
						subsys-name = "Spare";
					};

					LDO25M {
						channel-mux-selection = <0x39>;
						phandle = <0x51>;
						regulator-initial-mode = <0x3>;
						regulator-max-microvolt = <0x1dc130>;
						regulator-min-microvolt = <0x186a00>;
						regulator-name = "S2MPG10_LDO25";
						schematic-name = "L25M_TSP_DVDD";
						subsys-name = "Touch";
					};

					LDO26M {
						channel-mux-selection = <0x3a>;
						phandle = <0x52>;
						regulator-initial-mode = <0x3>;
						regulator-max-microvolt = <0x325aa0>;
						regulator-min-microvolt = <0x2625a0>;
						regulator-name = "S2MPG10_LDO26";
						schematic-name = "L26M_TS_AVDD";
						subsys-name = "Touch";
					};

					LDO27M {
						channel-mux-selection = <0x3b>;
						phandle = <0x7d>;
						regulator-initial-mode = <0x3>;
						regulator-max-microvolt = <0x325aa0>;
						regulator-min-microvolt = <0x2625a0>;
						regulator-name = "S2MPG10_LDO27";
						schematic-name = "L27M_UDFPS_AVDD";
						subsys-name = "UDFPS";
					};

					LDO28M {
						channel-mux-selection = <0x3c>;
						phandle = <0x7e>;
						regulator-initial-mode = <0x3>;
						regulator-max-microvolt = <0x13d620>;
						regulator-min-microvolt = <0xb1008>;
						regulator-name = "S2MPG10_LDO28";
						schematic-name = "L28M_DISP_VDDD";
						subsys-name = "Display";
					};

					LDO29M {
						channel-mux-selection = <0x3d>;
						phandle = <0x7f>;
						regulator-max-microvolt = <0x1dc130>;
						regulator-min-microvolt = <0x186a00>;
						regulator-name = "S2MPG10_LDO29";
						schematic-name = "L29M_UNUSED";
						subsys-name = "Spare";
					};

					LDO2M {
						channel-mux-selection = <0x22>;
						phandle = <0x6f>;
						regulator-always-on;
						regulator-initial-mode = <0x3>;
						regulator-max-microvolt = <0x1dc130>;
						regulator-min-microvolt = <0x186a00>;
						regulator-name = "S2MPG10_LDO2";
						schematic-name = "L2M_ALIVE";
						subsys-name = "DDR";
					};

					LDO30M {
						channel-mux-selection = <0x3e>;
						phandle = <0x5e>;
						regulator-always-on;
						regulator-max-microvolt = <0x1dc130>;
						regulator-min-microvolt = <0x186a00>;
						regulator-name = "S2MPG10_LDO30";
						schematic-name = "L30M_UNUSED";
						subsys-name = "Spare";
					};

					LDO31M {
						channel-mux-selection = <0x3f>;
						phandle = <0x49>;
						regulator-initial-mode = <0x3>;
						regulator-max-microvolt = <0x1dc130>;
						regulator-min-microvolt = <0x186a00>;
						regulator-name = "S2MPG10_LDO31";
						schematic-name = "L31M_NFC";
						subsys-name = "NFC";
					};

					LDO3M {
						channel-mux-selection = <0x23>;
						phandle = <0x70>;
						regulator-always-on;
						regulator-initial-mode = <0x1>;
						regulator-max-microvolt = <0x13d620>;
						regulator-min-microvolt = <0xb1008>;
						regulator-name = "S2MPG10_LDO3";
						schematic-name = "L3M";
						subsys-name = "IO";
					};

					LDO4M {
						channel-mux-selection = <0x24>;
						phandle = <0x71>;
						regulator-always-on;
						regulator-initial-mode = <0x1>;
						regulator-max-microvolt = <0x1dc130>;
						regulator-min-microvolt = <0x186a00>;
						regulator-name = "S2MPG10_LDO4";
						schematic-name = "L4M";
						subsys-name = "IO";
					};

					LDO5M {
						channel-mux-selection = <0x25>;
						phandle = <0x72>;
						regulator-always-on;
						regulator-initial-mode = <0x1>;
						regulator-max-microvolt = <0x13d620>;
						regulator-min-microvolt = <0xb1008>;
						regulator-name = "S2MPG10_LDO5";
						schematic-name = "L5M_TCXO";
						subsys-name = "PLL";
					};

					LDO6M {
						channel-mux-selection = <0x26>;
						phandle = <0x73>;
						regulator-always-on;
						regulator-initial-mode = <0x1>;
						regulator-max-microvolt = <0x13d620>;
						regulator-min-microvolt = <0xb1008>;
						regulator-name = "S2MPG10_LDO6";
						schematic-name = "L6M_PLL";
						subsys-name = "PLL";
					};

					LDO7M {
						channel-mux-selection = <0x27>;
						phandle = <0x23>;
						regulator-initial-mode = <0x3>;
						regulator-max-microvolt = <0xe7ef0>;
						regulator-min-microvolt = <0x6ddd0>;
						regulator-name = "S2MPG10_LDO7";
						schematic-name = "L7M_VDD_HSI";
						subsys-name = "IO";
					};

					LDO8M {
						channel-mux-selection = <0x28>;
						phandle = <0x24>;
						regulator-initial-mode = <0x3>;
						regulator-max-microvolt = <0x13d620>;
						regulator-min-microvolt = <0xb1008>;
						regulator-name = "S2MPG10_LDO8";
						schematic-name = "L8M_USB";
						subsys-name = "USB";
					};

					LDO9M {
						channel-mux-selection = <0x29>;
						phandle = <0x25>;
						regulator-initial-mode = <0x3>;
						regulator-max-microvolt = <0x1dc130>;
						regulator-min-microvolt = <0x186a00>;
						regulator-name = "S2MPG10_LDO9";
						schematic-name = "L9M_USB";
						subsys-name = "USB";
					};
				};

				s2mpg10_gpio {
					#gpio-cells = <0x2>;
					gpio-controller;
					gpio-ranges = <0x19 0x0 0x0 0x6>;
					ngpios = <0x6>;
					phandle = <0x8b>;
				};

				s2mpg10_pinctrl {
					phandle = <0x19>;
				};
			};
		};
	};

	fragment@15 {
		target = <0xffffffff>;

		__overlay__ {
			#address-cells = <0x1>;
			#size-cells = <0x0>;
			status = "okay";

			s2mpg11mfd@00 {
				#thermal-sensor-cells = <0x1>;
				acpm-ipc-channel = <0x2>;
				acpm-speedy-channel = <0x1>;
				b2_ocp_warn_cnt = <0x0>;
				b2_ocp_warn_dvs_mask = <0x0>;
				b2_ocp_warn_en = <0x1>;
				b2_ocp_warn_lvl = <0x8>;
				b2_soft_ocp_warn_cnt = <0x0>;
				b2_soft_ocp_warn_dvs_mask = <0x0>;
				b2_soft_ocp_warn_en = <0x1>;
				b2_soft_ocp_warn_lvl = <0x8>;
				buck_ocp_ctrl1 = <0xbb>;
				buck_ocp_ctrl2 = <0xbb>;
				buck_ocp_ctrl3 = <0xbb>;
				buck_ocp_ctrl4 = <0xbb>;
				buck_ocp_ctrl5 = <0xbb>;
				buck_ocp_ctrl6 = <0xbb>;
				buck_ocp_ctrl7 = <0xb>;
				compatible = "samsung,s2mpg11mfd";
				dev-name = "s2mpg11mfd";
				gpios = <0xffffffff 0x0 0x0 0xffffffff 0x2 0x0>;
				interrupt-parent = <0xffffffff>;
				interrupts = <0x1 0x0 0x0 0x1 0x0 0x1>;
				phandle = <0x1d>;
				pinctrl-0 = <0x1a>;
				pinctrl-names = "default";
				reg = <0x2f>;
				s2mpg11,irq-gpio = <0xffffffff 0x7 0x0>;
				s2mpg11,wakeup = "enabled";

				odpm {
					chip-name = "S2MPG11";
					max-refresh-time-ms = <0xdbba0>;
					sample-rate-external-uhz = <0x1d19574>;
					sample-rate-uhz = <0x7735940>;

					channels {

						channel@0 {
							channel_enabled;
							phandle = <0xa5>;
							rail-name = "VSEN_C6";
						};

						channel@1 {
							channel_enabled;
							phandle = <0xa6>;
							rail-name = "LDO2S";
						};

						channel@2 {
							channel_enabled;
							phandle = <0xa7>;
							rail-name = "BUCK9S";
						};

						channel@3 {
							channel_enabled;
							phandle = <0xa8>;
							rail-name = "BUCK5S";
						};

						channel@4 {
							channel_enabled;
							phandle = <0xa9>;
							rail-name = "BUCK10S";
						};

						channel@5 {
							channel_enabled;
							phandle = <0xaa>;
							rail-name = "BUCK4S";
						};

						channel@6 {
							channel_enabled;
							phandle = <0xab>;
							rail-name = "BUCK2S";
						};

						channel@7 {
							channel_enabled;
							phandle = <0xac>;
							rail-name = "VSEN_C4";
						};
					};

					rails {
						use-regulators-as-rails;

						VSEN_C4 {
							channel-en-index = <0x1>;
							channel-mux-selection = <0x5c>;
							external_rail;
							phandle = <0xad>;
							schematic-name = "VSYS_PWR_DISPLAY";
							shunt-res-uohms = <0x2710>;
							subsys-name = "Display";
						};

						VSEN_C5 {
							channel-en-index = <0x2>;
							channel-mux-selection = <0x5d>;
							external_rail;
							phandle = <0xae>;
							schematic-name = "VSEN_C5_NC";
							shunt-res-uohms = <0x2710>;
							subsys-name = "Spare";
						};

						VSEN_C6 {
							channel-en-index = <0x4>;
							channel-mux-selection = <0x5e>;
							external_rail;
							phandle = <0xaf>;
							schematic-name = "VSYS_PWR_MMWAVE";
							shunt-res-uohms = <0x2710>;
							subsys-name = "Cellular";
						};
					};
				};

				regulators {

					BUCK10S {
						buck_rail;
						channel-en-byte-offset = <0x1>;
						channel-en-index = <0x2>;
						channel-mux-selection = <0xa>;
						phandle = <0x95>;
						regulator-always-on;
						regulator-initial-mode = <0x3>;
						regulator-max-microvolt = <0x13d620>;
						regulator-min-microvolt = <0x6ddd0>;
						regulator-name = "S2MPG11_BUCK10";
						schematic-name = "S10S_VDD2L";
						subsys-name = "DDR";
					};

					BUCK1S {
						buck_rail;
						channel-en-byte-offset = <0x0>;
						channel-en-index = <0x1>;
						channel-mux-selection = <0x1>;
						odpm_disable_in_sleep;
						phandle = <0x8c>;
						regulator-always-on;
						regulator-initial-mode = <0x1>;
						regulator-max-microvolt = <0x13d620>;
						regulator-min-microvolt = <0x6ddd0>;
						regulator-name = "S2MPG11_BUCK1";
						schematic-name = "S1S_VDD_CAM";
						subsys-name = "Multimedia";
					};

					BUCK2S {
						buck_rail;
						channel-en-byte-offset = <0x0>;
						channel-en-index = <0x2>;
						channel-mux-selection = <0x2>;
						odpm_disable_in_sleep;
						phandle = <0x8d>;
						regulator-always-on;
						regulator-initial-mode = <0x1>;
						regulator-max-microvolt = <0x13d620>;
						regulator-min-microvolt = <0x6ddd0>;
						regulator-name = "S2MPG11_BUCK2";
						schematic-name = "S2S_VDD_G3D";
						subsys-name = "GPU";
					};

					BUCK3S {
						buck_rail;
						channel-en-byte-offset = <0x0>;
						channel-en-index = <0x4>;
						channel-mux-selection = <0x3>;
						phandle = <0x8e>;
						regulator-always-on;
						regulator-initial-mode = <0x3>;
						regulator-max-microvolt = <0x13d620>;
						regulator-min-microvolt = <0x6ddd0>;
						regulator-name = "S2MPG11_BUCK3";
						schematic-name = "S3S_LLDO1";
						subsys-name = "LDO";
					};

					BUCK4S {
						buck_rail;
						channel-en-byte-offset = <0x0>;
						channel-en-index = <0x8>;
						channel-mux-selection = <0x4>;
						phandle = <0x8f>;
						regulator-always-on;
						regulator-initial-mode = <0x3>;
						regulator-max-microvolt = <0x13d620>;
						regulator-min-microvolt = <0x6ddd0>;
						regulator-name = "S2MPG11_BUCK4";
						schematic-name = "S4S_VDD2H_MEM";
						subsys-name = "DDR";
					};

					BUCK5S {
						buck_rail;
						channel-en-byte-offset = <0x0>;
						channel-en-index = <0x10>;
						channel-mux-selection = <0x5>;
						phandle = <0x90>;
						regulator-always-on;
						regulator-initial-mode = <0x1>;
						regulator-max-microvolt = <0x13d620>;
						regulator-min-microvolt = <0x61a80>;
						regulator-name = "S2MPG11_BUCK5";
						schematic-name = "S5S_VDDQ_MEM";
						subsys-name = "DDR";
					};

					BUCK6S {
						buck_rail;
						channel-en-byte-offset = <0x0>;
						channel-en-index = <0x20>;
						channel-mux-selection = <0x6>;
						phandle = <0x91>;
						regulator-always-on;
						regulator-initial-mode = <0x3>;
						regulator-max-microvolt = <0x16e360>;
						regulator-min-microvolt = <0xf4240>;
						regulator-name = "S2MPG11_BUCK6";
						schematic-name = "S6S_LLDO4";
						subsys-name = "LDO";
					};

					BUCK7S {
						buck_rail;
						channel-en-byte-offset = <0x0>;
						channel-en-index = <0x40>;
						channel-mux-selection = <0x7>;
						phandle = <0x92>;
						regulator-always-on;
						regulator-initial-mode = <0x3>;
						regulator-max-microvolt = <0x2191c0>;
						regulator-min-microvolt = <0x16e360>;
						regulator-name = "S2MPG11_BUCK7";
						schematic-name = "S7S_MLDO";
						subsys-name = "LDO";
					};

					BUCK8S {
						buck_rail;
						channel-en-byte-offset = <0x0>;
						channel-en-index = <0x80>;
						channel-mux-selection = <0x8>;
						odpm_disable_in_sleep;
						phandle = <0x93>;
						regulator-always-on;
						regulator-initial-mode = <0x1>;
						regulator-max-microvolt = <0x13d620>;
						regulator-min-microvolt = <0x6ddd0>;
						regulator-name = "S2MPG11_BUCK8";
						schematic-name = "S8S_VDD_G3D_L2";
						subsys-name = "GPU";
					};

					BUCK9S {
						buck_rail;
						channel-en-byte-offset = <0x1>;
						channel-en-index = <0x1>;
						channel-mux-selection = <0x9>;
						phandle = <0x94>;
						regulator-always-on;
						regulator-initial-mode = <0x3>;
						regulator-max-microvolt = <0x13d620>;
						regulator-min-microvolt = <0x6ddd0>;
						regulator-name = "S2MPG11_BUCK9";
						schematic-name = "S9S_VDD_AOC";
						subsys-name = "AOC";
					};

					BUCKA {
						buck_rail;
						channel-en-byte-offset = <0x1>;
						channel-en-index = <0x8>;
						channel-mux-selection = <0xc>;
						phandle = <0x5a>;
						regulator-always-on;
						regulator-initial-mode = <0x3>;
						regulator-max-microvolt = <0x200b20>;
						regulator-min-microvolt = <0x19f0a0>;
						regulator-name = "S2MPG11_BUCKA";
						schematic-name = "SA";
						subsys-name = "IO";
					};

					BUCKBOOST {
						buck_rail;
						channel-en-byte-offset = <0x1>;
						channel-en-index = <0x10>;
						channel-mux-selection = <0xd>;
						phandle = <0x97>;
						regulator-always-on;
						regulator-initial-mode = <0x3>;
						regulator-max-microvolt = <0x36ee80>;
						regulator-min-microvolt = <0x2dc6c0>;
						regulator-name = "S2MPG11_BUCKBOOST";
						schematic-name = "BB_HLDO";
						subsys-name = "LDO";
					};

					BUCKD {
						buck_rail;
						channel-en-byte-offset = <0x1>;
						channel-en-index = <0x4>;
						channel-mux-selection = <0xb>;
						odpm_disable_in_sleep;
						phandle = <0x96>;
						regulator-always-on;
						regulator-initial-mode = <0x1>;
						regulator-max-microvolt = <0x325aa0>;
						regulator-min-microvolt = <0x249f00>;
						regulator-name = "S2MPG11_BUCKD";
						schematic-name = "SD";
						subsys-name = "UFS";
					};

					LDO10S {
						channel-mux-selection = <0x2a>;
						phandle = <0x9f>;
						regulator-always-on;
						regulator-initial-mode = <0x3>;
						regulator-max-microvolt = <0x1dc130>;
						regulator-min-microvolt = <0x186a00>;
						regulator-name = "S2MPG11_LDO10";
						schematic-name = "L10S_GNSS_RF";
						subsys-name = "GPS";
					};

					LDO11S {
						channel-mux-selection = <0x2b>;
						phandle = <0xa0>;
						regulator-always-on;
						regulator-initial-mode = <0x3>;
						regulator-max-microvolt = <0x1dc130>;
						regulator-min-microvolt = <0x186a00>;
						regulator-name = "S2MPG11_LDO11";
						schematic-name = "L11S_GNSS_AUX";
						subsys-name = "GPS";
					};

					LDO12S {
						channel-mux-selection = <0x2c>;
						phandle = <0xa1>;
						regulator-max-microvolt = <0x1dc130>;
						regulator-min-microvolt = <0x186a00>;
						regulator-name = "S2MPG11_LDO12";
						schematic-name = "L12S_UNUSED";
						subsys-name = "Spare";
					};

					LDO13S {
						channel-mux-selection = <0x2d>;
						phandle = <0xa2>;
						regulator-always-on;
						regulator-initial-mode = <0x1>;
						regulator-max-microvolt = <0x331df0>;
						regulator-min-microvolt = <0x1b7740>;
						regulator-name = "S2MPG11_LDO13";
						schematic-name = "L13S_DPAUX";
						subsys-name = "Display";
					};

					LDO14S {
						channel-mux-selection = <0x2e>;
						phandle = <0xa3>;
						regulator-initial-mode = <0x3>;
						regulator-max-microvolt = <0x1dc130>;
						regulator-min-microvolt = <0x186a00>;
						regulator-name = "S2MPG11_LDO14";
						schematic-name = "L14S_UWB";
						subsys-name = "UWB";
					};

					LDO15S {
						channel-mux-selection = <0x2f>;
						phandle = <0xa4>;
						regulator-max-microvolt = <0x1dc130>;
						regulator-min-microvolt = <0x186a00>;
						regulator-name = "S2MPG11_LDO15";
						schematic-name = "L15S_UNUSED";
						subsys-name = "Spare";
					};

					LDO1S {
						channel-mux-selection = <0x21>;
						phandle = <0x98>;
						regulator-always-on;
						regulator-initial-mode = <0x1>;
						regulator-max-microvolt = <0xe7ef0>;
						regulator-min-microvolt = <0x6ddd0>;
						regulator-name = "S2MPG11_LDO1";
						schematic-name = "L1S_VDD_G3D_M";
						subsys-name = "GPU";
					};

					LDO2S {
						channel-mux-selection = <0x22>;
						phandle = <0x99>;
						regulator-always-on;
						regulator-initial-mode = <0x1>;
						regulator-max-microvolt = <0xe7ef0>;
						regulator-min-microvolt = <0x6ddd0>;
						regulator-name = "S2MPG11_LDO2";
						schematic-name = "L2S_VDD_AOC_RET";
						subsys-name = "AOC";
					};

					LDO3S {
						channel-mux-selection = <0x23>;
						phandle = <0x9a>;
						regulator-max-microvolt = <0x1dc130>;
						regulator-min-microvolt = <0x186a00>;
						regulator-name = "S2MPG11_LDO3";
						schematic-name = "L3S_UNUSED";
						subsys-name = "Spare";
					};

					LDO4S {
						channel-mux-selection = <0x24>;
						phandle = <0x9b>;
						regulator-always-on;
						regulator-initial-mode = <0x3>;
						regulator-max-microvolt = <0x325aa0>;
						regulator-min-microvolt = <0x2625a0>;
						regulator-name = "S2MPG11_LDO4";
						schematic-name = "L4S_UWB";
						subsys-name = "UWB";
					};

					LDO5S {
						channel-mux-selection = <0x25>;
						phandle = <0x9c>;
						regulator-max-microvolt = <0x1dc130>;
						regulator-min-microvolt = <0x186a00>;
						regulator-name = "S2MPG11_LDO5";
						schematic-name = "L5S_UNUSED";
						subsys-name = "Spare";
					};

					LDO6S {
						channel-mux-selection = <0x26>;
						phandle = <0x2c>;
						regulator-boot-on;
						regulator-initial-mode = <0x3>;
						regulator-max-microvolt = <0x325aa0>;
						regulator-min-microvolt = <0x2625a0>;
						regulator-name = "S2MPG11_LDO6";
						schematic-name = "L6S_PROX";
						subsys-name = "Sensors";
					};

					LDO7S {
						channel-mux-selection = <0x27>;
						phandle = <0x2b>;
						regulator-boot-on;
						regulator-initial-mode = <0x3>;
						regulator-max-microvolt = <0x1dc130>;
						regulator-min-microvolt = <0x186a00>;
						regulator-name = "S2MPG11_LDO7";
						schematic-name = "L7S_SENSORS";
						subsys-name = "Sensors";
					};

					LDO8S {
						channel-mux-selection = <0x28>;
						phandle = <0x9d>;
						regulator-always-on;
						regulator-initial-mode = <0x1>;
						regulator-max-microvolt = <0x138288>;
						regulator-min-microvolt = <0x113578>;
						regulator-name = "S2MPG11_LDO8";
						schematic-name = "L8S_UFS_VCCQ";
						subsys-name = "UFS";
					};

					LDO9S {
						channel-mux-selection = <0x29>;
						phandle = <0x9e>;
						regulator-always-on;
						regulator-initial-mode = <0x3>;
						regulator-max-microvolt = <0x13d620>;
						regulator-min-microvolt = <0xb1008>;
						regulator-name = "S2MPG11_LDO9";
						schematic-name = "L9S_GNSS_CORE";
						subsys-name = "GPS";
					};
				};

				s2mpg11_gpio {
					#gpio-cells = <0x2>;
					gpio-controller;
					gpio-ranges = <0x1b 0x0 0x0 0x6>;
					ngpios = <0x6>;
					phandle = <0x2d>;
				};

				s2mpg11_pinctrl {
					phandle = <0x1b>;
				};
			};
		};
	};

	fragment@16 {
		target = <0xffffffff>;

		__overlay__ {
			main-pmic = <0x1c>;
			sub-pmic = <0x1d>;
		};
	};

	fragment@17 {
		target = <0xffffffff>;

		__overlay__ {
			status = "okay";
		};
	};

	fragment@18 {
		target = <0xffffffff>;

		__overlay__ {

			key-voldown {
				phandle = <0x1e>;
				samsung,pin-drv = <0x0>;
				samsung,pin-function = <0xf>;
				samsung,pin-pud = <0x0>;
				samsung,pins = "gpa7-3";
			};

			key-volup {
				phandle = <0x1f>;
				samsung,pin-drv = <0x0>;
				samsung,pin-function = <0xf>;
				samsung,pin-pud = <0x0>;
				samsung,pins = "gpa8-1";
			};
		};
	};

	fragment@19 {
		target = <0xffffffff>;

		__overlay__ {

			key-power {
				phandle = <0x20>;
				samsung,pin-drv = <0x0>;
				samsung,pin-function = <0xf>;
				samsung,pin-pud = <0x0>;
				samsung,pins = "gpa10-1";
			};
		};
	};

	fragment@2 {
		target = <0xffffffff>;

		__overlay__ {
			status = "okay";
		};
	};

	fragment@20 {
		target = <0xffffffff>;

		__overlay__ {
			pinctrl-0 = <0x1e 0x1f 0x20>;
			pinctrl-names = "default";
			status = "okay";

			button@1 {
				gpios = <0xffffffff 0x3 0xf>;
				label = "gpio-keys: KEY_VOLUMEDOWN";
				linux,code = <0x72>;
				wakeup-source;
			};

			button@2 {
				gpios = <0xffffffff 0x1 0xf>;
				label = "gpio-keys: KEY_VOLUMEUP";
				linux,code = <0x73>;
				wakeup-source;
			};

			button@3 {
				gpios = <0xffffffff 0x1 0xf>;
				label = "gpio-keys: KEY_POWER";
				linux,code = <0x74>;
				wakeup-source;
			};
		};
	};

	fragment@21 {
		target = <0xffffffff>;

		__overlay__ {
			adj-sof-accuracy = <0x1>;
			elastic_buf_mode_quirk;
			extcon = <0x13>;
			samsung,no-extra-delay;
			u1u2_exitfail_quirk;
			usb3-lpm-capable;
			usb_host_device_timeout = <0x7ff>;
			ux_exit_in_px_quirk;
			xhci_l2_support = <0x1>;

			dwc3 {
				dr_mode = "peripheral";
				maximum-speed = "super-speed-plus";
				phandle = <0xb0>;
				snps,dis-u1-entry-quirk;
				snps,dis-u2-entry-quirk;
				snps,dis-u2-freeclk-exists-quirk;
				snps,has-lpm-erratum;
				snps,lpm-nyet-threshold = <0x0>;
				snps,quirk-frame-length-adjustment = <0x20>;
				snps,usb3_lpm_capable;
				usb-psy-name = "usb";
				usb3-lpm-capable;
				xhci_l2_support = <0x1>;
			};
		};
	};

	fragment@22 {
		target = <0xffffffff>;

		__overlay__ {

			hs_tune {
				hs_tune_cnt = <0x6>;
				phandle = <0x21>;
				status = "disabled";

				hs_tune1 {
					tune_name = "tx_pre_emp";
					tune_value = <0x3 0x3>;
				};

				hs_tune2 {
					tune_name = "tx_vref";
					tune_value = <0xf 0xf>;
				};

				hs_tune3 {
					tune_name = "rx_sqrx";
					tune_value = <0x5 0x5>;
				};

				hs_tune4 {
					tune_name = "utmi_clk";
					tune_value = <0x1 0x1>;
				};

				hs_tune5 {
					tune_name = "compdis";
					tune_value = <0x7 0x7>;
				};

				hs_tune6 {
					tune_name = "tx_res";
					tune_value = <0x3 0x3>;
				};
			};

			ss_tune {
				phandle = <0x22>;
				ss_tune_cnt = <0x24>;
				status = "disabled";

				ss_tune1 {
					tune_name = "ssrx_sqhs_th_ss";
					tune_value = <0xffffffff 0xffffffff>;
				};

				ss_tune10 {
					tune_name = "ssrx_hf_eq_rsel_ctrl_ssp";
					tune_value = <0xffffffff 0xffffffff>;
				};

				ss_tune11 {
					tune_name = "ssrx_hf_eq_csel_ctrl_ss";
					tune_value = <0xffffffff 0xffffffff>;
				};

				ss_tune12 {
					tune_name = "ssrx_hf_eq_csel_ctrl_ssp";
					tune_value = <0xffffffff 0xffffffff>;
				};

				ss_tune13 {
					tune_name = "ssrx_dfe_1tap_ctrl_ss";
					tune_value = <0xffffffff 0xffffffff>;
				};

				ss_tune14 {
					tune_name = "ssrx_dfe_1tap_ctrl_ssp";
					tune_value = <0xffffffff 0xffffffff>;
				};

				ss_tune15 {
					tune_name = "ssrx_dfe_2tap_ctrl_ss";
					tune_value = <0xffffffff 0xffffffff>;
				};

				ss_tune16 {
					tune_name = "ssrx_dfe_2tap_ctrl_ssp";
					tune_value = <0xffffffff 0xffffffff>;
				};

				ss_tune17 {
					tune_name = "ssrx_dfe_3tap_ctrl_ss";
					tune_value = <0xffffffff 0xffffffff>;
				};

				ss_tune18 {
					tune_name = "ssrx_dfe_3tap_ctrl_ssp";
					tune_value = <0xffffffff 0xffffffff>;
				};

				ss_tune19 {
					tune_name = "ssrx_dfe_4tap_ctrl_ss";
					tune_value = <0xffffffff 0xffffffff>;
				};

				ss_tune2 {
					tune_name = "ssrx_sqhs_th_ssp";
					tune_value = <0xffffffff 0xffffffff>;
				};

				ss_tune20 {
					tune_name = "ssrx_dfe_4tap_ctrl_ssp";
					tune_value = <0xffffffff 0xffffffff>;
				};

				ss_tune21 {
					tune_name = "ssrx_dfe_5tap_ctrl_ss";
					tune_value = <0xffffffff 0xffffffff>;
				};

				ss_tune22 {
					tune_name = "ssrx_dfe_5tap_ctrl_ssp";
					tune_value = <0xffffffff 0xffffffff>;
				};

				ss_tune23 {
					tune_name = "ssrx_term_cal";
					tune_value = <0xffffffff 0xffffffff>;
				};

				ss_tune24 {
					tune_name = "sstx_amp_ss";
					tune_value = <0xffffffff 0xffffffff>;
				};

				ss_tune25 {
					tune_name = "sstx_deemp_ss";
					tune_value = <0xffffffff 0xffffffff>;
				};

				ss_tune26 {
					tune_name = "sstx_pre_shoot_ss";
					tune_value = <0xffffffff 0xffffffff>;
				};

				ss_tune27 {
					tune_name = "sstx_amp_ssp";
					tune_value = <0xffffffff 0xffffffff>;
				};

				ss_tune28 {
					tune_name = "sstx_deemp_ssp";
					tune_value = <0xffffffff 0xffffffff>;
				};

				ss_tune29 {
					tune_name = "sstx_pre_shoot_ssp";
					tune_value = <0xffffffff 0xffffffff>;
				};

				ss_tune3 {
					tune_name = "ssrx_lfps_th";
					tune_value = <0xffffffff 0xffffffff>;
				};

				ss_tune30 {
					tune_name = "sstx_idrv_up";
					tune_value = <0xffffffff 0xffffffff>;
				};

				ss_tune31 {
					tune_name = "sstx_lfps_idrv_up";
					tune_value = <0xffffffff 0xffffffff>;
				};

				ss_tune32 {
					tune_name = "sstx_up_term";
					tune_value = <0xffffffff 0xffffffff>;
				};

				ss_tune33 {
					tune_name = "sstx_dn_term";
					tune_value = <0xffffffff 0xffffffff>;
				};

				ss_tune34 {
					tune_name = "rext_ovrd";
					tune_value = <0xffffffff 0xffffffff>;
				};

				ss_tune35 {
					tune_name = "ssrx_cdr_fbb_fine_ctrl_sp";
					tune_value = <0xffffffff 0xffffffff>;
				};

				ss_tune36 {
					tune_name = "ssrx_cdr_fbb_fine_ctrl_ssp";
					tune_value = <0xffffffff 0xffffffff>;
				};

				ss_tune4 {
					tune_name = "ssrx_adap_coef_sel";
					tune_value = <0xffffffff 0xffffffff>;
				};

				ss_tune5 {
					tune_name = "ssrx_mf_eq_psel_ctrl_ss";
					tune_value = <0xffffffff 0xffffffff>;
				};

				ss_tune6 {
					tune_name = "ssrx_mf_eq_psel_ctrl_ssp";
					tune_value = <0xffffffff 0xffffffff>;
				};

				ss_tune7 {
					tune_name = "ssrx_mf_eq_zsel_ctrl_ss";
					tune_value = <0xffffffff 0xffffffff>;
				};

				ss_tune8 {
					tune_name = "ssrx_mf_eq_zsel_ctrl_ssp";
					tune_value = <0xffffffff 0xffffffff>;
				};

				ss_tune9 {
					tune_name = "ssrx_hf_eq_rsel_ctrl_ss";
					tune_value = <0xffffffff 0xffffffff>;
				};
			};
		};
	};

	fragment@23 {
		target = <0xffffffff>;

		__overlay__ {
			extcon = <0x13>;
			hs_tune_param = <0x21>;
			ss_tune_param = <0x22>;
			status = "okay";
			vdd085-supply = <0x24>;
			vdd18-supply = <0x25>;
			vdd30-supply = <0x26>;
			vdd_hsi-supply = <0x23>;
		};
	};

	fragment@24 {
		target = <0xffffffff>;

		__overlay__ {
			ep-device-type = <0x4>;
			phy-power-off = "false";
			status = "okay";
			use-cache-coherency = "true";
			use-ia = "true";
			use-l1ss = "true";
			use-msi = "true";
			use-pcieon-sleep = "true";
			use-sicd = "true";
			vreg1-supply = <0x27>;
			vreg2-supply = <0x28>;
		};
	};

	fragment@25 {
		target = <0xffffffff>;

		__overlay__ {
			ep-device-type = <0x1>;
			max-link-speed = <0x2>;
			num-lanes = <0x1>;
			pcie,wlan-gpio = <0xffffffff 0x2 0x1>;
			status = "okay";
			use-ia = "true";
			use-l1ss = "true";
			use-phy-isol-en = "true";
			use-sicd = "true";
			vreg1-supply = <0x29>;
			vreg2-supply = <0x2a>;
		};
	};

	fragment@26 {
		target = <0xffffffff>;

		__overlay__ {
			sensor_1v8-supply = <0x2b>;
			sensor_3v3-supply = <0x2c>;
			sensor_power_list = "sensor_1v8", "sensor_3v3";
		};
	};

	fragment@27 {
		target = <0xffffffff>;

		__overlay__ {
			#address-cells = <0x1>;
			#size-cells = <0x0>;
			status = "ok";

			slg51000@75 {
				compatible = "dlg,slg51000";
				dlg,cs-gpios = <0x2d 0x0 0x0>;
				phandle = <0xb1>;
				reg = <0x75>;
				status = "ok";

				regulators {

					ldo1 {
						phandle = <0x34>;
						regulator-max-microvolt = <0x325aa0>;
						regulator-min-microvolt = <0x225510>;
						regulator-name = "ldo1";
					};

					ldo2 {
						phandle = <0x39>;
						regulator-max-microvolt = <0x325aa0>;
						regulator-min-microvolt = <0x225510>;
						regulator-name = "ldo2";
					};

					ldo3 {
						phandle = <0x35>;
						regulator-max-microvolt = <0x393870>;
						regulator-min-microvolt = <0x124f80>;
						regulator-name = "ldo3";
					};

					ldo4 {
						phandle = <0x36>;
						regulator-max-microvolt = <0x393870>;
						regulator-min-microvolt = <0x124f80>;
						regulator-name = "ldo4";
					};

					ldo5 {
						phandle = <0x3a>;
						regulator-max-microvolt = <0x124f80>;
						regulator-min-microvolt = <0x7a120>;
						regulator-name = "ldo5";
					};

					ldo6 {
						phandle = <0x37>;
						regulator-max-microvolt = <0x124f80>;
						regulator-min-microvolt = <0x7a120>;
						regulator-name = "ldo6";
					};

					ldo7 {
						phandle = <0x38>;
						regulator-max-microvolt = <0x393870>;
						regulator-min-microvolt = <0x124f80>;
						regulator-name = "ldo7";
					};
				};
			};
		};
	};

	fragment@28 {
		target = <0xffffffff>;

		__overlay__ {

			hsi2c2-bus {
				phandle = <0x2f>;
				samsung,pin-pud = <0x3>;
			};

			hsi2c2-bus-in {
				phandle = <0x2e>;
				samsung,pin-drv = <0x0>;
				samsung,pin-function = <0x0>;
				samsung,pin-pud = <0x0>;
				samsung,pins = "gpp4-0", "gpp4-1";
			};

			hsi2c3-bus {
				phandle = <0x31>;
				samsung,pin-pud = <0x3>;
			};

			hsi2c3-bus-in {
				phandle = <0x30>;
				samsung,pin-drv = <0x0>;
				samsung,pin-function = <0x0>;
				samsung,pin-pud = <0x0>;
				samsung,pins = "gpp6-0", "gpp6-1";
			};

			hsi2c4-bus {
				phandle = <0x33>;
				samsung,pin-pud = <0x3>;
			};

			hsi2c4-bus-in {
				phandle = <0x32>;
				samsung,pin-drv = <0x0>;
				samsung,pin-function = <0x0>;
				samsung,pin-pud = <0x0>;
				samsung,pins = "gpp8-0", "gpp8-1";
			};
		};
	};

	fragment@29 {
		target = <0xffffffff>;

		__overlay__ {

			flash_active {
				phandle = <0x3b>;
				samsung,pin-function = <0x1>;
				samsung,pin-pud = <0x0>;
				samsung,pins = "gpp27-1";
			};

			flash_suspend {
				phandle = <0x3c>;
				samsung,pin-function = <0x0>;
				samsung,pin-pud = <0x1>;
				samsung,pins = "gpp27-1";
			};
		};
	};

	fragment@3 {
		target = <0xffffffff>;

		__overlay__ {

			btbcm {
				compatible = "goog,nitrous";
				device-wakeup-gpios = <0xffffffff 0x3 0x0>;
				host-wakeup-gpios = <0xffffffff 0x6 0x0>;
				phandle = <0x61>;
				pinctrl-0 = <0x1 0x2 0x3>;
				pinctrl-names = "default";
				shutdown-gpios = <0xffffffff 0x2 0x0>;
				status = "okay";
			};
		};
	};

	fragment@30 {
		target = <0xffffffff>;

		__overlay__ {
			#address-cells = <0x1>;
			#size-cells = <0x0>;
			clock-frequency = <0xf4240>;
			gpios = <0xffffffff 0x0 0x0 0xffffffff 0x1 0x0>;
			pinctrl-0 = <0x2e>;
			pinctrl-1 = <0x2f>;
			pinctrl-2 = <0x2e>;
			pinctrl-names = "default", "on_i2c", "off_i2c";
			samsung,reset-before-trans;
			status = "okay";
		};
	};

	fragment@31 {
		target = <0xffffffff>;

		__overlay__ {
			#address-cells = <0x1>;
			#size-cells = <0x0>;
			clock-frequency = <0xf4240>;
			gpios = <0xffffffff 0x0 0x0 0xffffffff 0x1 0x0>;
			pinctrl-0 = <0x30>;
			pinctrl-1 = <0x31>;
			pinctrl-2 = <0x30>;
			pinctrl-names = "default", "on_i2c", "off_i2c";
			samsung,reset-before-trans;
			status = "okay";
		};
	};

	fragment@32 {
		target = <0xffffffff>;

		__overlay__ {
			#address-cells = <0x1>;
			#size-cells = <0x0>;
			clock-frequency = <0xf4240>;
			gpios = <0xffffffff 0x0 0x0 0xffffffff 0x1 0x0>;
			pinctrl-0 = <0x32>;
			pinctrl-1 = <0x33>;
			pinctrl-2 = <0x32>;
			pinctrl-names = "default", "on_i2c", "off_i2c";
			samsung,reset-before-trans;
			status = "okay";
		};
	};

	fragment@33 {
		target = <0xffffffff>;

		__overlay__ {
			#address-cells = <0x1>;
			#size-cells = <0x0>;
			clock-frequency = <0x61a80>;
			gpios = <0xffffffff 0x0 0x0 0xffffffff 0x1 0x0>;
			pinctrl-0 = <0xffffffff>;
			pinctrl-1 = <0xffffffff>;
			pinctrl-2 = <0xffffffff>;
			pinctrl-names = "default", "on_i2c", "off_i2c";
			status = "okay";
		};
	};

	fragment@34 {
		target = <0xffffffff>;

		__overlay__ {

			goodixfp {
				compatible = "goodix,fingerprint";
				fp-gpio-irq = <0xffffffff 0x7 0x0>;
				fp-gpio-reset = <0xffffffff 0x3 0x1>;
				interrupt-parent = <0xffffffff>;
				interrupts = <0x7 0x0>;
				pinctrl-names = "default";
				spi-max-frequency = <0xf4240>;
				status = "okay";
			};
		};
	};

	fragment@35 {
		target = <0xffffffff>;

		__overlay__ {
			#address-cells = <0x1>;
			#size-cells = <0x0>;
			pinctrl-0 = <0xffffffff>;
			pinctrl-names = "default";
			status = "okay";

			m24c08@50 {
				compatible = "at,24c08";
				phandle = <0x3d>;
				reg = <0x50>;
				status = "okay";
			};
		};
	};

	fragment@36 {
		target = <0xffffffff>;

		__overlay__ {
			samsung,pin-pud = <0x3>;
			samsung,pins = "gpp23-4", "gpp23-5";
		};
	};

	fragment@37 {
		target = <0xffffffff>;

		__overlay__ {
			samsung,pin-con-pdn = <0x3>;
			samsung,pin-pud-pdn = <0x0>;
		};
	};

	fragment@38 {
		target = <0xffffffff>;

		__overlay__ {
			#address-cells = <0x1>;
			#size-cells = <0x0>;
			pinctrl-0 = <0xffffffff 0xffffffff>;
			pinctrl-names = "default";
			status = "okay";

			cpboot_spi@0 {
				compatible = "samsung,exynos-cp-spi";
				reg = <0x0>;
				spi-max-frequency = <0x20ce70>;

				controller-data {
					samsung,spi-chip-select-mode = <0x1>;
					samsung,spi-feedback-delay = <0x0>;
				};
			};
		};
	};

	fragment@39 {
		target = <0xffffffff>;

		__overlay__ {
			num_sensors = <0x9>;
		};
	};

	fragment@4 {
		target = <0xffffffff>;

		__overlay__ {
			#address-cells = <0x1>;
			#size-cells = <0x0>;
			pinctrl-0 = <0xffffffff 0xffffffff>;
			pinctrl-names = "default";
			status = "okay";

			bcm4775@0 {
				compatible = "ssp,bcm4775";
				mcu-req-gpios = <0xffffffff 0x1 0x0>;
				nstandby-gpios = <0xffffffff 0x2 0x1>;
				pinctrl-0 = <0x4 0x5 0x6 0x7>;
				pinctrl-names = "default";
				reg = <0x0>;
				spi-cpha;
				spi-cpol;
				spi-max-frequency = <0x18cba80>;

				controller-data {
					samsung,spi-chip-select-mode = <0x0>;
					samsung,spi-feedback-delay = <0x1>;
				};
			};
		};
	};

	fragment@40 {
		target = <0xffffffff>;

		__overlay__ {

			cp_on_chip_0 {
				polling-delay = <0x0>;
				polling-delay-passive = <0x0>;
				thermal-governor = "user_space";
				thermal-sensors = <0xffffffff 0x0>;

				trips {

					trip_config {
						hysteresis = <0x3e8>;
						temperature = <0x1e848>;
						type = "passive";
					};
				};
			};

			cp_on_chip_1 {
				polling-delay = <0x0>;
				polling-delay-passive = <0x0>;
				thermal-governor = "user_space";
				thermal-sensors = <0xffffffff 0x1>;

				trips {

					trip_config {
						hysteresis = <0x3e8>;
						temperature = <0x1e848>;
						type = "passive";
					};
				};
			};

			cp_on_chip_2 {
				polling-delay = <0x0>;
				polling-delay-passive = <0x0>;
				thermal-governor = "user_space";
				thermal-sensors = <0xffffffff 0x2>;

				trips {

					trip_config {
						hysteresis = <0x3e8>;
						temperature = <0x1e848>;
						type = "passive";
					};
				};
			};

			cp_on_chip_3 {
				polling-delay = <0x0>;
				polling-delay-passive = <0x0>;
				thermal-governor = "user_space";
				thermal-sensors = <0xffffffff 0x3>;

				trips {

					trip_config {
						hysteresis = <0x3e8>;
						temperature = <0x1e848>;
						type = "passive";
					};
				};
			};

			cp_on_chip_4 {
				polling-delay = <0x0>;
				polling-delay-passive = <0x0>;
				thermal-governor = "user_space";
				thermal-sensors = <0xffffffff 0x4>;

				trips {

					trip_config {
						hysteresis = <0x3e8>;
						temperature = <0x1e848>;
						type = "passive";
					};
				};
			};

			cp_on_chip_5 {
				polling-delay = <0x0>;
				polling-delay-passive = <0x0>;
				thermal-governor = "user_space";
				thermal-sensors = <0xffffffff 0x5>;

				trips {

					trip_config {
						hysteresis = <0x3e8>;
						temperature = <0x1e848>;
						type = "passive";
					};
				};
			};

			cp_on_chip_6 {
				polling-delay = <0x0>;
				polling-delay-passive = <0x0>;
				thermal-governor = "user_space";
				thermal-sensors = <0xffffffff 0x6>;

				trips {

					trip_config {
						hysteresis = <0x3e8>;
						temperature = <0x1e848>;
						type = "passive";
					};
				};
			};

			rf1_therm {
				polling-delay = <0x0>;
				polling-delay-passive = <0x0>;
				thermal-governor = "user_space";
				thermal-sensors = <0xffffffff 0x8>;

				trips {

					trip_config {
						hysteresis = <0x3e8>;
						temperature = <0x1e848>;
						type = "passive";
					};
				};
			};

			rf2_therm {
				polling-delay = <0x0>;
				polling-delay-passive = <0x0>;
				thermal-governor = "user_space";
				thermal-sensors = <0xffffffff 0x7>;

				trips {

					trip_config {
						hysteresis = <0x3e8>;
						temperature = <0x1e848>;
						type = "passive";
					};
				};
			};
		};
	};

	fragment@41 {
		target = <0xffffffff>;

		__overlay__ {

			s5100_cp2ap_cp_ps_hold {
				phandle = <0x41>;
				samsung,pin-function = <0xf>;
				samsung,pin-pud = <0x0>;
				samsung,pins = "gpa9-5";
			};
		};
	};

	fragment@42 {
		target = <0xffffffff>;

		__overlay__ {

			s5100_cp2ap_wakeup {
				phandle = <0x43>;
				samsung,pin-function = <0xf>;
				samsung,pin-pud = <0x0>;
				samsung,pins = "gpa8-4";
			};
		};
	};

	fragment@43 {
		target = <0xffffffff>;

		__overlay__ {

			s5100_ap2cp_cp_nreset_n {
				phandle = <0x40>;
				samsung,pin-con-pdn = <0x3>;
				samsung,pin-pud = <0x0>;
				samsung,pin-pud-pdn = <0x0>;
				samsung,pins = "gph1-3";
			};

			s5100_ap2cp_cp_pwr_on {
				phandle = <0x3f>;
				samsung,pin-con-pdn = <0x3>;
				samsung,pin-pud = <0x0>;
				samsung,pin-pud-pdn = <0x0>;
				samsung,pins = "gph1-0";
			};

			s5100_ap2cp_dump_noti {
				phandle = <0x44>;
				samsung,pin-con-pdn = <0x3>;
				samsung,pin-pud = <0x0>;
				samsung,pin-pud-pdn = <0x0>;
				samsung,pins = "gph0-3";
			};

			s5100_ap2cp_pda_active {
				phandle = <0x45>;
				samsung,pin-con-pdn = <0x3>;
				samsung,pin-pud = <0x0>;
				samsung,pin-pud-pdn = <0x0>;
				samsung,pins = "gph1-1";
			};

			s5100_ap2cp_wakeup {
				phandle = <0x42>;
				samsung,pin-con-pdn = <0x3>;
				samsung,pin-pud = <0x0>;
				samsung,pin-pud-pdn = <0x0>;
				samsung,pins = "gph0-2";
			};
		};
	};

	fragment@44 {
		target = <0xffffffff>;

		__overlay__ {
			#address-cells = <0x1>;
			#size-cells = <0x0>;
			status = "ok";

			panel@0 {
				channel = <0x0>;
				compatible = "samsung,s6e3hc2-fhd";
				label = "samsung-s6e3hc2-fhd";
				reset-gpios = <0xffffffff 0x1 0x0>;
				touch = <0x47>;
				vci-supply = <0x48>;
				vddi-supply = <0x49>;
			};

			panel@1 {
				channel = <0x0>;
				compatible = "samsung,emul";
				label = "samsung-emul";
				reset-gpios = <0xffffffff 0x1 0x0>;
			};
		};
	};

	fragment@45 {
		target = <0xffffffff>;

		__overlay__ {
			status = "disabled";
		};
	};

	fragment@46 {
		target = <0xffffffff>;

		__overlay__ {

			nfc-pidle {
				phandle = <0x4b>;
				samsung,pin-con-pdn = <0x3>;
				samsung,pin-pud = <0x3>;
				samsung,pin-pud-pdn = <0x3>;
				samsung,pins = "gpp26-2";
			};

			nfc-rst {
				phandle = <0x4a>;
				samsung,pin-pud-pdn = <0x3>;
				samsung,pins = "gpp24-2";
			};
		};
	};

	fragment@47 {
		target = <0xffffffff>;

		__overlay__ {
			samsung,pin-con-pdn = <0x3>;
			samsung,pin-pud-pdn = <0x0>;
		};
	};

	fragment@48 {
		target = <0xffffffff>;

		__overlay__ {
			#address-cells = <0x1>;
			#size-cells = <0x0>;
			clock-frequency = <0x5a550>;
			status = "okay";

			st21nfc@08 {
				clkreq-gpios = <0xffffffff 0x4 0x0>;
				clock-names = "nfc_ref_clk";
				clocks = <0xffffffff 0x60f>;
				compatible = "st,st21nfc";
				dev-name = "st21nfc";
				interrupt-parent = <0xffffffff>;
				interrupts = <0x0 0x0 0x0>;
				irq-gpios = <0xffffffff 0x0 0x0>;
				pidle-gpios = <0xffffffff 0x2 0x0>;
				pinctrl-0 = <0x4a 0x4b>;
				pinctrl-names = "default";
				pmu_clk_pad = <0x3e80>;
				reg = <0x8>;
				reset-gpios = <0xffffffff 0x2 0x0>;
				st,pidle_active_low;
				status = "ok";
			};
		};
	};

	fragment@49 {
		target = <0xffffffff>;

		__overlay__ {
			max-link-speed = <0x1>;
		};
	};

	fragment@5 {
		target = <0xffffffff>;

		__overlay__ {

			gps-mcu-req {
				phandle = <0x5>;
				samsung,pin-con-pdn = <0x3>;
				samsung,pin-function = <0x1>;
				samsung,pin-pud = <0x0>;
				samsung,pin-pud-pdn = <0x0>;
				samsung,pins = "gpp1-1";
			};

			gps-nstandby {
				phandle = <0x7>;
				samsung,pin-con-pdn = <0x3>;
				samsung,pin-function = <0x1>;
				samsung,pin-pud = <0x0>;
				samsung,pin-pud-pdn = <0x0>;
				samsung,pins = "gpp0-2";
			};
		};
	};

	fragment@50 {
		target = <0xffffffff>;

		__overlay__ {

			sec_ts-irq {
				phandle = <0x4e>;
				samsung,pin-drv = <0x0>;
				samsung,pin-pud = <0x0>;
				samsung,pins = "gpa9-0";
			};
		};
	};

	fragment@51 {
		target = <0xffffffff>;

		__overlay__ {

			sec_ts-reset {
				phandle = <0x4f>;
				samsung,pin-pud = <0x0>;
				samsung,pins = "gpp26-0";
			};

			sec_ts-switch {
				phandle = <0x50>;
				samsung,pin-pud = <0x0>;
				samsung,pins = "gpp26-1";
			};

			spi11-bus {
				phandle = <0x4c>;
				samsung,pin-drv = <0x1>;
				samsung,pin-function = <0x2>;
				samsung,pin-pud = <0x0>;
				samsung,pins = "gpp23-0", "gpp23-1", "gpp23-2";
			};

			spi11-cs {
				phandle = <0xbc>;
				samsung,pin-drv = <0x1>;
				samsung,pin-function = <0x1>;
				samsung,pin-pud = <0x0>;
				samsung,pins = "gpp23-3";
			};

			spi11-cs-func {
				phandle = <0x4d>;
				samsung,pin-drv = <0x1>;
				samsung,pin-function = <0x2>;
				samsung,pin-pud = <0x0>;
				samsung,pins = "gpp23-3";
			};
		};
	};

	fragment@52 {
		target = <0xffffffff>;

		__overlay__ {
			#address-cells = <0x1>;
			#size-cells = <0x0>;
			pinctrl-0 = <0x4c 0x4d>;
			pinctrl-names = "default";
			status = "okay";

			touchscreen@0 {
				avdd-supply = <0x52>;
				compatible = "sec,sec_ts";
				phandle = <0x47>;
				pinctrl-0 = <0x4e 0x4f 0x50>;
				pinctrl-names = "default";
				reg = <0x0>;
				sec,firmware_name = "s6sy79x.bin";
				sec,heatmap_mode = <0x1>;
				sec,irq_gpio = <0xffffffff 0x0 0x0>;
				sec,max_coords = <0x438 0x924>;
				sec,mis_cal_check = <0x1>;
				sec,reset_gpio = <0xffffffff 0x0 0x0>;
				sec,switch_gpio = <0xffffffff 0x1 0x0>;
				spi-cpha;
				spi-cpol;
				spi-max-frequency = <0xf42400>;
				status = "ok";
				vdd-supply = <0x51>;

				controller-data {
					samsung,spi-chip-select-mode = <0x1>;
					samsung,spi-feedback-delay = <0x0>;
				};
			};
		};
	};

	fragment@53 {
		target = <0xffffffff>;

		__overlay__ {

			ap_gsc_irq {
				phandle = <0x54>;
				samsung,pin-drv = <0x0>;
				samsung,pin-function = <0x1>;
				samsung,pin-pud = <0x0>;
				samsung,pins = "gpa4-1";
			};
		};
	};

	fragment@54 {
		target = <0xffffffff>;

		__overlay__ {

			ap-dtls-cs {
				phandle = <0x53>;
				samsung,pin-pud-pdn = <0x0>;
				samsung,pins = "gpp21-3";
			};
		};
	};

	fragment@55 {
		target = <0xffffffff>;

		__overlay__ {
			#address-cells = <0x1>;
			#size-cells = <0x0>;
			pinctrl-0 = <0xffffffff 0xffffffff 0x53>;
			pinctrl-names = "default";
			status = "okay";

			gsc@0 {
				compatible = "google,gsc";
				gsc,ctdl_ap_irq = <0xffffffff 0x1 0x0>;
				gsc,ctdl_rst = <0xffffffff 0x2 0x0>;
				interrupt-parent = <0xffffffff>;
				interrupts = <0x5 0x0 0x0>;
				pinctrl-0 = <0x54>;
				pinctrl-names = "default";
				reg = <0x0>;
				spi-max-frequency = <0x124f80>;

				controller-data {
					samsung,spi-chip-select-mode = <0x0>;
					samsung,spi-feedback-delay = <0x1>;
				};
			};
		};
	};

	fragment@56 {
		target = <0xffffffff>;

		__overlay__ {

			bcm4775@0 {
				host-req-gpios = <0xffffffff 0x0 0x0>;
				mcu-resp-gpios = <0xffffffff 0x4 0x0>;
			};
		};
	};

	fragment@57 {
		target = <0xffffffff>;

		__overlay__ {

			gps-mcu-resp {
				phandle = <0x6>;
				samsung,pin-con-pdn = <0x3>;
				samsung,pin-function = <0x0>;
				samsung,pin-pud = <0x1>;
				samsung,pin-pud-pdn = <0x1>;
				samsung,pins = "gpa6-4";
			};
		};
	};

	fragment@58 {
		target = <0xffffffff>;

		__overlay__ {

			gps-host-req {
				phandle = <0x4>;
				samsung,pin-con-pdn = <0x3>;
				samsung,pin-function = <0xf>;
				samsung,pin-pud = <0x0>;
				samsung,pin-pud-pdn = <0x0>;
				samsung,pins = "gpp0-0";
			};
		};
	};

	fragment@59 {
		target = <0xffffffff>;

		__overlay__ {

			codec {
				sound-dai = <0x55 0x0 0x56 0x0>;
			};
		};
	};

	fragment@6 {
		target = <0xffffffff>;

		__overlay__ {
			#address-cells = <0x1>;
			#size-cells = <0x0>;
			status = "okay";

			fusb307b@50 {
				chg-psy-name = "gcpm";
				compatible = "fusb307b";
				conn = <0xa>;
				interrupt-parent = <0xffffffff>;
				ls = <0x9>;
				no-bc-12;
				orientation-switch;
				phandle = <0x62>;
				pinctrl-0 = <0x8>;
				pinctrl-names = "default";
				reg = <0x50>;
				status = "disabled";
				usb-psy-name = "usb";
				usbpd,usbpd_int = <0xffffffff 0x2 0x1>;

				connector {
					compatible = "usb-c-connector";
					data-role = "dual";
					label = "USB-C";
					op-sink-microwatt = <0x27ac40>;
					phandle = <0xa>;
					power-role = "dual";
					self-powered;
					sink-pdos = <0x2601912c 0x2d0c8>;
					source-pdos = <0x3601905a>;
					try-power-role = "sink";
					usb-role-switch;

					port {
						#address-cells = <0x1>;
						#size-cells = <0x0>;

						endpoint@0 {
							phandle = <0xc>;
							reg = <0x0>;
							remote-endpoint = <0xb>;
						};
					};
				};

				port {
					#address-cells = <0x1>;
					#size-cells = <0x0>;

					endpoint@0 {
						phandle = <0xb>;
						reg = <0x0>;
						remote-endpoint = <0xc>;
					};
				};
			};

			max20339ovp@35 {
				compatible = "max20339ovp";
				max20339,irq-gpio = <0xd 0x5 0x1>;
				phandle = <0xf>;
				reg = <0x35>;
				status = "okay";

				max20339_gpio {
					#gpio-cells = <0x2>;
					gpio-controller;
					ngpios = <0x8>;
					phandle = <0xe>;
				};
			};

			max77759tcpc@25 {
				chg-psy-name = "gcpm";
				compatible = "max77759tcpc";
				conn = <0x10>;
				dev-name = "max77759tcpc";
				in-switch-gpio = <0xe 0x4 0x0>;
				interrupt-parent = <0xffffffff>;
				max20339,ovp = <0xf>;
				orientation-switch;
				phandle = <0x13>;
				pinctrl-0 = <0x8>;
				pinctrl-names = "default";
				reg = <0x25>;
				status = "okay";
				usb-psy-name = "usb";
				usbpd,usbpd_int = <0xffffffff 0x2 0x1>;

				connector {
					compatible = "usb-c-connector";
					data-role = "dual";
					label = "USB-C";
					new-source-frs-typec-current = <0x2>;
					op-sink-microwatt = <0x27ac40>;
					phandle = <0x10>;
					power-role = "dual";
					self-powered;
					sink-pdos = <0x3601912c 0x2d0dc 0xc0dc323c>;
					sink-vdos = <0xd14018d1 0x0 0x4ee10000 0x45800001 0x0 0x23800000>;
					sink-vdos-v1 = <0xd00018d1 0x0 0x4ee10000>;
					slow-charger-loop;
					source-pdos = <0x3601905a>;
					try-power-role = "sink";
					usb-role-switch;

					port {
						#address-cells = <0x1>;
						#size-cells = <0x0>;

						endpoint@0 {
							phandle = <0x12>;
							reg = <0x0>;
							remote-endpoint = <0x11>;
						};
					};
				};

				max77759_tcpc_gpio {
					#gpio-cells = <0x2>;
					gpio-controller;
					ngpios = <0x1>;
					phandle = <0x63>;
				};

				port {
					#address-cells = <0x1>;
					#size-cells = <0x0>;

					endpoint@0 {
						phandle = <0x11>;
						reg = <0x0>;
						remote-endpoint = <0x12>;
					};
				};
			};

			slg46826@8 {
				compatible = "slg46826";
				phandle = <0x9>;
				reg = <0x8>;
				status = "disabled";
			};
		};
	};

	fragment@60 {
		target = <0xffffffff>;

		__overlay__ {

			codec {
				sound-dai = <0x55 0x0 0x56 0x0>;
			};
		};
	};

	fragment@61 {
		target = <0xffffffff>;

		__overlay__ {

			clks {

				sys {

					sys@cs35l41_l {
						comp = <0x55>;
						id = <0x0>;
						in_mul = <0x1>;
						out_mul = <0x1>;
						src = "BCLK";
						srcid = <0x0>;
					};

					sys@cs35l41_r {
						comp = <0x56>;
						id = <0x0>;
						in_mul = <0x1>;
						out_mul = <0x1>;
						src = "BCLK";
						srcid = <0x0>;
					};
				};
			};
		};
	};

	fragment@62 {
		target = <0xffffffff>;

		__overlay__ {

			cs35l41-r-irq {
				phandle = <0x5c>;
				samsung,pin-function = <0xf>;
				samsung,pin-pud = <0x0>;
				samsung,pins = "gpa9-6";
			};
		};
	};

	fragment@63 {
		target = <0xffffffff>;

		__overlay__ {

			cs35l41-l-irq {
				phandle = <0x59>;
				samsung,pin-function = <0xf>;
				samsung,pin-pud = <0x0>;
				samsung,pins = "gpa6-3";
			};
		};
	};

	fragment@64 {
		target = <0xffffffff>;

		__overlay__ {

			cs35l41-l-rst {
				phandle = <0x58>;
				samsung,pin-con-pdn = <0x3>;
				samsung,pin-function = <0x1>;
				samsung,pin-pud = <0x0>;
				samsung,pin-pud-pdn = <0x0>;
				samsung,pins = "gpp16-3";
			};
		};
	};

	fragment@65 {
		target = <0xffffffff>;

		__overlay__ {

			cs35l41-r-rst {
				phandle = <0x5b>;
				samsung,pin-con-pdn = <0x3>;
				samsung,pin-function = <0x1>;
				samsung,pin-pud = <0x0>;
				samsung,pin-pud-pdn = <0x0>;
				samsung,pins = "gpp23-7";
			};

			hapt-amp-rst {
				phandle = <0x57>;
				samsung,pin-con-pdn = <0x3>;
				samsung,pin-function = <0x1>;
				samsung,pin-pud = <0x0>;
				samsung,pin-pud-pdn = <0x0>;
				samsung,pins = "gpp24-0";
			};

			hapt-amp-trig {
				phandle = <0xbd>;
				samsung,pin-con-pdn = <0x3>;
				samsung,pin-function = <0x1>;
				samsung,pin-pud = <0x0>;
				samsung,pin-pud-pdn = <0x0>;
				samsung,pins = "gpp24-3";
			};
		};
	};

	fragment@66 {
		target = <0xffffffff>;

		__overlay__ {
			#address-cells = <0x1>;
			#size-cells = <0x0>;
			clock-frequency = <0x61a80>;
			pinctrl-0 = <0xffffffff>;
			pinctrl-names = "default";
			status = "okay";

			cs35l41@40 {
				#sound-dai-cells = <0x1>;
				VA-supply = <0x5a>;
				VP-supply = <0xffffffff>;
				cirrus,asp-sdout-hiz = <0x3>;
				cirrus,boost-cap-microfarad = <0x1e>;
				cirrus,boost-ind-nanohenry = <0x3e8>;
				cirrus,boost-peak-milliamp = <0xdac>;
				cirrus,left-channel-amp;
				cirrus,tuning-has-prefix;
				compatible = "cirrus,cs35l41";
				interrupt-parent = <0xffffffff>;
				interrupts = <0x3 0x0 0x0>;
				phandle = <0x55>;
				pinctrl-0 = <0x58 0x59>;
				pinctrl-names = "default";
				reg = <0x40>;
				reset-gpios = <0xffffffff 0x3 0x0>;

				cirrus,gpio-config2 {
					cirrus,gpio-output-enable;
					cirrus,gpio-src-select = <0x5>;
				};
			};

			cs35l41@41 {
				#sound-dai-cells = <0x1>;
				VA-supply = <0x5a>;
				VP-supply = <0xffffffff>;
				cirrus,asp-sdout-hiz = <0x3>;
				cirrus,boost-cap-microfarad = <0x1e>;
				cirrus,boost-ind-nanohenry = <0x3e8>;
				cirrus,boost-peak-milliamp = <0xdac>;
				cirrus,left-channel-amp;
				cirrus,tuning-has-prefix;
				compatible = "cirrus,cs35l41";
				interrupt-parent = <0xffffffff>;
				interrupts = <0x6 0x0 0x0>;
				phandle = <0x56>;
				pinctrl-0 = <0x5b 0x5c>;
				pinctrl-names = "default";
				reg = <0x41>;
				reset-gpios = <0xffffffff 0x7 0x0>;
				sound-name-prefix = [52 00];

				cirrus,gpio-config2 {
					cirrus,gpio-output-enable;
					cirrus,gpio-src-select = <0x5>;
				};
			};

			drv2624_haptics@5a {
				compatible = "ti,drv2624";
				pinctrl-0 = <0x57>;
				pinctrl-names = "default";
				reg = <0x5a>;
				status = "okay";
				ti,actuator = <0x1>;
				ti,bemf-factor = <0xbc>;
				ti,bemf-gain = <0x1>;
				ti,blanking-time = <0x2>;
				ti,idiss-time = <0x2>;
				ti,lra-frequency = <0x9b>;
				ti,lra-wave-shape = <0x0>;
				ti,odclamp-voltage = <0xa5>;
				ti,ol-lra-frequency = <0x9b>;
				ti,rated-voltage = <0x4d>;
				ti,reset-gpio = <0xffffffff 0x0 0x0>;
				ti,smart-loop = <0x0>;
				ti,voltage-comp = <0x9>;
				ti,waveform-interval = <0x1>;
				ti,zc-det-time = <0x0>;
			};
		};
	};

	fragment@67 {
		target = <0xffffffff>;

		__overlay__ {
			aoc-board-cfg = "wf1";
			aoc-board-id = <0x201>;
			aoc-board-rev = <0x200>;
		};
	};

	fragment@68 {
		target = <0xffffffff>;

		__overlay__ {

			if-pmic-fg-irq {
				phandle = <0xbe>;
				samsung,pin-drv = <0x0>;
				samsung,pin-function = <0xf>;
				samsung,pin-pud = <0x3>;
				samsung,pins = "gpa9-3";
			};
		};
	};

	fragment@69 {
		target = <0xffffffff>;

		__overlay__ {

			if-pmic-irq {
				phandle = <0x5d>;
				samsung,pin-drv = <0x0>;
				samsung,pin-function = <0xf>;
				samsung,pin-pud = <0x3>;
				samsung,pins = "gpa8-3";
			};
		};
	};

	fragment@7 {
		target = <0xffffffff>;

		__overlay__ {
			samsung,pin-pud = <0x3>;
			samsung,pins = "gpp23-4", "gpp23-5";
		};
	};

	fragment@70 {
		target = <0xffffffff>;

		__overlay__ {
			#address-cells = <0x1>;
			#size-cells = <0x0>;
			clock-frequency = <0x61a80>;
			status = "okay";

			max77729chrg@0x69 {
				compatible = "maxim,max77729chrg";
				max77729,irq-gpio = <0xffffffff 0x3 0x1>;
				max77729,psy-name = "main-charger";
				reg = <0x69>;
				status = "okay";
			};

			max77729fg@0x36 {
				compatible = "maxim,max77729f";
				maxim,batt-id-range-pct = <0x0>;
				maxim,irq-gpio = <0xffffffff 0x3 0x1>;
				maxim,irqf-shared;
				maxim,psy-type-unknown;
				maxim,rsense-default = <0x1f4>;
				phandle = <0xc1>;
				reg = <0x36>;
				status = "okay";

				maxim,fg-data {

					maxim,config {

						maxim,r3-default-0k {
							maxim,batt-id-kohm = <0x0>;
							maxim,fg-model = <0x8e708ed0 0xb6f0b8c0 0xbaa0bbf0 0xbd40be60 0xbfa0c180 0xc370c680 0xc7f0cfc0 0xd5c0dc70 0x200070 0xf001000 0x10c01250 0x179017f0 0xbf00bc0 0x79007f0 0x75006b0 0x6d006d0 0x20002000 0x20002000 0x20002000 0x20002000 0x20002000 0x20002000 0x20002000 0x20002000>;
							maxim,fg-params = [f0 60 20 39 26 02 72 14 00 90 5a 00 0f a0 0f a0 0c 80 07 d1 0f a2 96 5a 22 80 10 00 06 81 06 82 00 3d 19 3b 02 80 ed 51 1e ba 00 14 09 d0 00 00 22 41 ce b4 16 80];
							maxim,model-version = <0x1>;
						};

						maxim,r3-default-2k {
							maxim,batt-id-kohm = <0x2>;
							maxim,fg-model = <0x8e708ed0 0xb6f0b8c0 0xbaa0bbf0 0xbd40be60 0xbfa0c180 0xc370c680 0xc7f0cfc0 0xd5c0dc70 0x200070 0xf001000 0x10c01250 0x179017f0 0xbf00bc0 0x79007f0 0x75006b0 0x6d006d0 0x2000200 0x2000200 0x2000200 0x2000200 0x2000200 0x2000200 0x2000200 0x2000200>;
							maxim,fg-params = [0c dc 20 39 26 06 42 17 00 90 5f 00 10 00 10 13 0c 80 01 00 10 00 a5 61 28 04 12 82 08 00 07 80 00 3d 19 3b 02 80 ed 51 1e ba 00 14 38 70 00 00 22 41 ce b4 16 80];
							maxim,model-version = <0x1>;
						};

						maxim,r3-default-a0-3k {
							maxim,batt-id-kohm = <0x3>;
							maxim,fg-model = <0x7fc08030 0xb600b950 0xba70bc10 0xbcf0bec0 0xc0f0c2e0 0xc520c9a0 0xcd50d120 0xd720dc90 0x200030 0xa001820 0xec01790 0x16a010d0 0xab00ad0 0x6f00870 0x5d00720 0x6200620 0x2000200 0x2000200 0x2000200 0x2000200 0x2000200 0x2000200 0x2000200 0x2000200>;
							maxim,fg-params = [0c dc 20 39 26 06 42 17 00 90 5f 00 10 12 10 13 0c 80 01 01 10 12 a5 61 27 02 12 00 06 80 05 00 00 38 15 34 02 80 ed 51 1e ba 00 14 38 70 00 00 22 41 ce b4 16 80];
							maxim,model-version = <0x1>;
						};

						maxim,r3-default-a1-3k {
							maxim,batt-id-kohm = <0x3>;
							maxim,fg-model = <0x7dd09ae0 0xb770b8d0 0xba90bc00 0xbcf0be90 0xc0b0c280 0xc520c930 0xcbb0d040 0xd720dbe0 0x200090 0x12201240 0xbf01840 0x17f011a0 0xbe008a0 0x7e00890 0x6e00620 0x7000700 0x2000200 0x2000200 0x2000200 0x2000200 0x2000200 0x2000200 0x2000200 0x2000200>;
							maxim,fg-params = [0c dc 20 39 26 06 42 17 00 90 5f 00 10 12 10 13 0c 80 01 01 10 12 a5 61 2d 00 14 80 08 00 07 80 08 a0 10 30 02 80 ed 51 1e ba 00 14 38 70 00 00 22 41 ce b4 16 80];
							maxim,model-version = <0x1>;
						};
					};
				};
			};

			max77729pmic@0x66 {
				compatible = "maxim,max77729pmic";
				max777x9,irq-gpio = <0xffffffff 0x3 0x1>;
				phandle = <0xbf>;
				pinctrl-0 = <0x5d>;
				pinctrl-names = "default";
				reg = <0x66>;
				status = "okay";

				max777x9_gpio {
					#gpio-cells = <0x2>;
					gpio-controller;
					ngpios = <0x6>;
					phandle = <0xd>;
				};
			};

			max77729uic@0x25 {
				bc1_config = <0xe5>;
				compatible = "maxim,max77729uic";
				max77729,irq-gpio = <0xffffffff 0x3 0x1>;
				phandle = <0xc0>;
				reg = <0x25>;
				status = "okay";
				usb-psy-name = "usb";
			};
		};
	};

	fragment@71 {
		target = <0xffffffff>;

		__overlay__ {

			s5100_cp2ap_phone_active {
				phandle = <0x46>;
				samsung,pin-con-pdn = <0x3>;
				samsung,pin-function = <0xf>;
				samsung,pin-pud = <0x0>;
				samsung,pins = "gph1-2";
			};
		};
	};

	fragment@72 {
		target = <0xffffffff>;

		__overlay__ {

			panel@0 {
				vddi-supply = <0x5e>;
			};
		};
	};

	fragment@73 {
		target = <0xffffffff>;

		__overlay__ {

			s2mpg11mfd@00 {

				gs101_spmic_tm1 {
					#thermal-sensor-cells = <0x1>;
					adc_chan_en = [00];
					compatible = "google,gs101-spmic-thermal";
					phandle = <0x5f>;
				};
			};
		};
	};

	fragment@74 {
		target = <0xffffffff>;

		__overlay__ {

			btn_therm {
				polling-delay = <0x0>;
				polling-delay-passive = <0x0>;
				thermal-governor = "user_space";
				thermal-sensors = <0x5f 0x4>;

				trips {

					trip-config4 {
						hysteresis = <0x3e8>;
						phandle = <0xc6>;
						temperature = <0x1e848>;
						type = "passive";
					};
				};
			};

			cam_therm {
				polling-delay = <0x0>;
				polling-delay-passive = <0x0>;
				thermal-governor = "user_space";
				thermal-sensors = <0x5f 0x3>;

				trips {

					trip-config3 {
						hysteresis = <0x3e8>;
						phandle = <0xc5>;
						temperature = <0x1e848>;
						type = "passive";
					};
				};
			};

			disp_therm {
				polling-delay = <0x0>;
				polling-delay-passive = <0x0>;
				thermal-governor = "user_space";
				thermal-sensors = <0x5f 0x5>;

				trips {

					trip-config5 {
						hysteresis = <0x3e8>;
						phandle = <0xc7>;
						temperature = <0x1e848>;
						type = "passive";
					};
				};
			};

			gnss_tcxo_therm {
				polling-delay = <0x0>;
				polling-delay-passive = <0x0>;
				thermal-governor = "user_space";
				thermal-sensors = <0x5f 0x7>;

				trips {

					trip-config7 {
						hysteresis = <0x3e8>;
						phandle = <0xc9>;
						temperature = <0x1e848>;
						type = "passive";
					};
				};
			};

			quiet_therm {
				polling-delay = <0x0>;
				polling-delay-passive = <0x0>;
				thermal-governor = "user_space";
				thermal-sensors = <0x5f 0x1>;

				trips {

					trip-config1 {
						hysteresis = <0x3e8>;
						phandle = <0xc3>;
						temperature = <0x1e848>;
						type = "passive";
					};
				};
			};

			soc_therm {
				polling-delay = <0x0>;
				polling-delay-passive = <0x0>;
				thermal-governor = "user_space";
				thermal-sensors = <0x5f 0x0>;

				trips {

					trip-config0 {
						hysteresis = <0x3e8>;
						phandle = <0xc2>;
						temperature = <0x1e848>;
						type = "passive";
					};
				};
			};

			ufs_stb_therm {
				polling-delay = <0x0>;
				polling-delay-passive = <0x0>;
				thermal-governor = "user_space";
				thermal-sensors = <0x5f 0x6>;

				trips {

					trip-config6 {
						hysteresis = <0x3e8>;
						phandle = <0xc8>;
						temperature = <0x1e848>;
						type = "passive";
					};
				};
			};

			usb_pwr_therm {
				polling-delay = <0x0>;
				polling-delay-passive = <0x0>;
				thermal-governor = "user_space";
				thermal-sensors = <0x5f 0x2>;

				trips {

					trip-config2 {
						hysteresis = <0x3e8>;
						phandle = <0xc4>;
						temperature = <0x1e848>;
						type = "passive";
					};
				};
			};
		};
	};

	fragment@75 {
		target = <0xffffffff>;

		__overlay__ {

			battery_cycle {
				polling-delay = <0x0>;
				polling-delay-passive = <0x64>;
				thermal-sensors = <0x3e>;
				zone_name = "BATTERY_CYCLE";
			};

			ocp_cpu1 {
				polling-delay = <0x0>;
				polling-delay-passive = <0x64>;
				thermal-sensors = <0x1c 0x1>;
				zone_name = "OCP_CPU1";

				trips {

					ocp-cpu1 {
						hysteresis = <0x64>;
						phandle = <0xcf>;
						temperature = <0x1b58>;
						type = "passive";
					};
				};
			};

			ocp_cpu2 {
				polling-delay = <0x0>;
				polling-delay-passive = <0x64>;
				thermal-sensors = <0x1c 0x2>;
				zone_name = "OCP_CPU2";

				trips {

					ocp-cpu2 {
						hysteresis = <0x64>;
						phandle = <0xd0>;
						temperature = <0x2ee0>;
						type = "passive";
					};
				};
			};

			ocp_gpu {
				polling-delay = <0x0>;
				polling-delay-passive = <0x64>;
				thermal-sensors = <0x1d 0x0>;
				zone_name = "OCP_GPU";

				trips {

					ocp-gpu {
						hysteresis = <0x64>;
						phandle = <0xd5>;
						temperature = <0x2ee0>;
						type = "passive";
					};
				};
			};

			ocp_tpu {
				polling-delay = <0x0>;
				polling-delay-passive = <0x64>;
				thermal-sensors = <0x1c 0x5>;
				zone_name = "OCP_TPU";

				trips {

					ocp-tpu {
						hysteresis = <0x64>;
						phandle = <0xd3>;
						temperature = <0x2904>;
						type = "passive";
					};
				};
			};

			pmic_120c {
				polling-delay = <0x0>;
				polling-delay-passive = <0x3e8>;
				thermal-sensors = <0x60 0x1>;
				zone_name = "PMIC_120C";

				trips {

					pmic-120c {
						hysteresis = <0x64>;
						phandle = <0xca>;
						temperature = <0x4b0>;
						type = "passive";
					};
				};
			};

			pmic_140c {
				polling-delay = <0x0>;
				polling-delay-passive = <0x3e8>;
				thermal-sensors = <0x60 0x2>;
				zone_name = "PMIC_140C";

				trips {

					pmic-140c {
						hysteresis = <0x64>;
						phandle = <0xcb>;
						temperature = <0x578>;
						type = "passive";
					};
				};
			};

			pmic_overheat {
				polling-delay = <0x0>;
				polling-delay-passive = <0x3e8>;
				thermal-sensors = <0x60 0x3>;
				zone_name = "PMIC_OVERHEAT";

				trips {

					pmic-overheat {
						hysteresis = <0x64>;
						phandle = <0xcc>;
						temperature = <0x7d0>;
						type = "passive";
					};
				};
			};

			smpl_gm {
				polling-delay = <0x0>;
				polling-delay-passive = <0x64>;
				thermal-sensors = <0x1c 0x0>;
				zone_name = "SMPL_GM";

				trips {

					smpl_0 {
						hysteresis = <0x64>;
						phandle = <0xce>;
						temperature = <0x578>;
						type = "passive";
					};
				};
			};

			soc {
				polling-delay = <0x0>;
				polling-delay-passive = <0x0>;
				thermal-sensors = <0x60 0x0>;
				zone_name = "BATT_SOC_MOD";

				trips {

					soc-trip {
						hysteresis = <0x0>;
						phandle = <0xcd>;
						temperature = <0x5a>;
						type = "passive";
					};
				};
			};

			soft_ocp_cpu1 {
				polling-delay = <0x0>;
				polling-delay-passive = <0x64>;
				thermal-sensors = <0x1c 0x3>;
				zone_name = "SOFT_OCP_CPU1";

				trips {

					soft-ocp-cpu1 {
						hysteresis = <0x64>;
						phandle = <0xd1>;
						temperature = <0x1b58>;
						type = "passive";
					};
				};
			};

			soft_ocp_cpu2 {
				polling-delay = <0x0>;
				polling-delay-passive = <0x64>;
				thermal-sensors = <0x1c 0x4>;
				zone_name = "SOFT_OCP_CPU2";

				trips {

					soft-ocp-cpu2 {
						hysteresis = <0x64>;
						phandle = <0xd2>;
						temperature = <0x2328>;
						type = "passive";
					};
				};
			};

			soft_ocp_gpu {
				polling-delay = <0x0>;
				polling-delay-passive = <0x64>;
				thermal-sensors = <0x1d 0x1>;
				zone_name = "SOFT_OCP_GPU";

				trips {

					soft-ocp-gpu {
						hysteresis = <0x64>;
						phandle = <0xd6>;
						temperature = <0x2328>;
						type = "passive";
					};
				};
			};

			soft_ocp_tpu {
				polling-delay = <0x0>;
				polling-delay-passive = <0x64>;
				thermal-sensors = <0x1c 0x6>;
				zone_name = "SOFT_OCP_TPU";

				trips {

					soft-ocp-tpu {
						hysteresis = <0x64>;
						phandle = <0xd4>;
						temperature = <0x2134>;
						type = "passive";
					};
				};
			};
		};
	};

	fragment@8 {
		target = <0xffffffff>;

		__overlay__ {

			usb-pd-irq {
				phandle = <0x8>;
				samsung,pin-drv = <0x0>;
				samsung,pin-function = <0xf>;
				samsung,pin-pud = <0x3>;
				samsung,pins = "gpa8-2";
			};
		};
	};

	fragment@9 {
		target = <0xffffffff>;

		__overlay__ {

			cfg_wlanen {
				phandle = <0x14>;
				samsung,pin-con-pdn = <0x3>;
				samsung,pin-drv = <0x0>;
				samsung,pin-function = <0x1>;
				samsung,pin-pud = <0x0>;
				samsung,pin-pud-pdn = <0x3>;
				samsung,pins = "gpp14-2";
			};
		};
	};

	fragment@battery {
		target-path = [2f 00];

		__overlay__ {

			google,battery {
				#cooling-cells = <0x2>;
				#thermal-sensor-cells = <0x0>;
				compatible = "google,battery";
				google,chg-battery-capacity = <0xfa0>;
				google,chg-cc-limits = <0x1e 0xa 0x0 0x32 0x1e 0x1e 0x64 0x46 0x32 0x50 0x32 0x32 0x32 0x32 0x0 0x1e 0x0 0x0>;
				google,chg-cv-limits = <0x401640 0x419ce0 0x432380>;
				google,chg-temp-limits = <0x0 0x64 0xc8 0x1a4 0x1cc 0x1e0 0x226>;
				google,fg-psy-name = "maxfg";
				phandle = <0x3e>;
				status = "okay";
			};

			google,charger {
				#cooling-cells = <0x2>;
				compatible = "google,charger";
				google,bat-power-supply = "battery";
				google,chg-power-supply = "gcpm";
				google,fv-max-uv = <0x432380>;
				google,therm-wlc-overrides-fcc;
				google,thermal-mitigation = <0x3d0900 0x2dc6c0 0x1e8480 0xf4240 0x7a120>;
				google,usb-power-supply = "usb";
				google,wlc-thermal-mitigation = <0x10c8e0 0x7a120 0x3d090 0x1adb0>;
				phandle = <0xbb>;
				status = "okay";
			};

			google,cpm {
				compatible = "google,cpm";
				google,chg-power-supplies = "main-charger";
				phandle = <0xba>;
				status = "okay";
			};

			google,mitigation {
				#thermal-sensor-cells = <0x1>;
				compatible = "google,google-bcl";
				cpu0_clkdivstep = <0x1>;
				cpu1_clkdivstep = <0x0>;
				cpu2_clkdivstep = <0x801>;
				google,main-power = <0x1c>;
				google,power-supply = <0x3e>;
				google,sub-power = <0x1d>;
				gpu_clkdivstep = <0x801>;
				gpu_con_heavy = <0xf04385>;
				gpu_con_light = <0x0>;
				mpmm_settings = <0x1a>;
				phandle = <0x60>;
				ppm_settings = <0x0>;
				tpu_clkdivstep = <0x201>;
				tpu_con_heavy = <0xf041c3>;
				tpu_con_light = <0xf041c5>;
			};

			google_bms {
				google,bee-name = "5-00500";
				nvmem = <0x3d>;
				nvmem-names = "5-00500";
			};
		};
	};

	fragment@boardbase {
		target-path = [2f 00];

		__overlay__ {
			compatible = "google,GS101 WHITEFIN", "google,GS101";
			model = "GS101 WHITEFIN based on GS101";
		};
	};

	fragment@lwiscamera {
		target-path = [2f 00];

		__overlay__ {

			actuator@0 {
				clock-names = "CIS_CLK0", "GATE_DFTMUX_CMU_CIS_CLK0";
				clock-rates = <0x16e3600 0x0>;
				clocks = <0xffffffff 0x3b 0xffffffff 0x32>;
				compatible = "google,lwis-i2c-device";
				enable-gpios = <0x2d 0x4 0x0>;
				i2c-addr = <0x3b>;
				i2c-bus = <0xffffffff>;
				node-name = "act0";
				phandle = <0xb5>;
				reg-addr-bitwidth = <0x10>;
				reg-value-bitwidth = <0x20>;
				regulator-voltages = <0x2b7cd0 0x1b7740>;
				regulators = <0x35 0x38>;
			};

			eeprom@0 {
				clock-names = "CIS_CLK0", "GATE_DFTMUX_CMU_CIS_CLK0";
				clock-rates = <0x16e3600 0x0>;
				clocks = <0xffffffff 0x3b 0xffffffff 0x32>;
				compatible = "google,lwis-i2c-device";
				enable-gpios = <0x2d 0x3 0x0 0x2d 0x4 0x0>;
				i2c-addr = <0x3b>;
				i2c-bus = <0xffffffff>;
				node-name = "eeprom0";
				phandle = <0xb6>;
				reg-addr-bitwidth = <0x10>;
				reg-value-bitwidth = <0x20>;
				regulator-voltages = <0x1b7740>;
				regulators = <0x38>;
				reset-gpios = <0xffffffff 0x3 0x0>;
			};

			eeprom@1 {
				clock-names = "CIS_CLK2", "GATE_DFTMUX_CMU_CIS_CLK2";
				clock-rates = <0x16e3600 0x0>;
				clocks = <0xffffffff 0x3d 0xffffffff 0x34>;
				compatible = "google,lwis-i2c-device";
				enable-gpios = <0x2d 0x2 0x0>;
				i2c-addr = <0x50>;
				i2c-bus = <0xffffffff>;
				node-name = "eeprom1";
				phandle = <0xb7>;
				reg-addr-bitwidth = <0x10>;
				reg-value-bitwidth = <0x8>;
				regulator-voltages = <0x2b7cd0 0x2b7cd0 0x10c8e0 0x1b7740>;
				regulators = <0x39 0x35 0x3a 0x38>;
				reset-gpios = <0xffffffff 0x2 0x0>;
			};

			eeprom@2 {
				clock-names = "CIS_CLK1", "GATE_DFTMUX_CMU_CIS_CLK1";
				clock-rates = <0x16e3600 0x0>;
				clocks = <0xffffffff 0x3c 0xffffffff 0x33>;
				compatible = "google,lwis-i2c-device";
				enable-gpios = <0x2d 0x1 0x0>;
				i2c-addr = <0x51>;
				i2c-bus = <0xffffffff>;
				node-name = "eeprom2";
				phandle = <0xb8>;
				reg-addr-bitwidth = <0x10>;
				reg-value-bitwidth = <0x8>;
				regulator-voltages = <0x1b7740>;
				regulators = <0x38>;
				reset-gpios = <0xffffffff 0x2 0x0>;
			};

			flash@0 {
				compatible = "google,lwis-i2c-device";
				enable-gpios = <0xffffffff 0x1 0x0 0xffffffff 0x0 0x1 0xffffffff 0x2 0x1>;
				i2c-addr = <0x63>;
				i2c-bus = <0xffffffff>;
				node-name = "flash0";
				phandle = <0xb9>;
				pinctrl-0 = <0x3b>;
				pinctrl-1 = <0x3c>;
				pinctrl-names = "mclk_on", "mclk_off";
				reg-addr-bitwidth = <0x8>;
				reg-value-bitwidth = <0x8>;
			};

			sensor@0 {
				clock-names = "CIS_CLK0", "GATE_DFTMUX_CMU_CIS_CLK0";
				clock-rates = <0x16e3600 0x0>;
				clocks = <0xffffffff 0x3b 0xffffffff 0x32>;
				compatible = "google,lwis-i2c-device";
				enable-gpios = <0x2d 0x3 0x0>;
				i2c-addr = <0x10>;
				i2c-bus = <0xffffffff>;
				node-name = "sensor0";
				phandle = <0xb2>;
				pinctrl-0 = <0xffffffff>;
				pinctrl-1 = <0xffffffff>;
				pinctrl-names = "mclk_on", "mclk_off";
				reg-addr-bitwidth = <0x10>;
				reg-value-bitwidth = <0x8>;
				regulator-voltages = <0x2b7cd0 0x2b7cd0 0x1b7740 0x10c8e0 0x1b7740>;
				regulators = <0x34 0x35 0x36 0x37 0x38>;
				reset-gpios = <0xffffffff 0x3 0x0>;
			};

			sensor@1 {
				clock-names = "CIS_CLK2", "GATE_DFTMUX_CMU_CIS_CLK2";
				clock-rates = <0x16e3600 0x0>;
				clocks = <0xffffffff 0x3d 0xffffffff 0x34>;
				compatible = "google,lwis-i2c-device";
				enable-gpios = <0x2d 0x2 0x0>;
				i2c-addr = <0x1a>;
				i2c-bus = <0xffffffff>;
				node-name = "sensor1";
				phandle = <0xb4>;
				pinctrl-0 = <0xffffffff>;
				pinctrl-1 = <0xffffffff>;
				pinctrl-names = "mclk_on", "mclk_off";
				reg-addr-bitwidth = <0x10>;
				reg-value-bitwidth = <0x8>;
				regulator-voltages = <0x2b7cd0 0x2b7cd0 0x10c8e0 0x1b7740>;
				regulators = <0x39 0x35 0x3a 0x38>;
				reset-gpios = <0xffffffff 0x2 0x0>;
			};

			sensor@2 {
				clock-names = "CIS_CLK1", "GATE_DFTMUX_CMU_CIS_CLK1";
				clock-rates = <0x16e3600 0x0>;
				clocks = <0xffffffff 0x3c 0xffffffff 0x33>;
				compatible = "google,lwis-i2c-device";
				enable-gpios = <0x2d 0x1 0x0>;
				i2c-addr = <0x1a>;
				i2c-bus = <0xffffffff>;
				node-name = "sensor2";
				phandle = <0xb3>;
				pinctrl-0 = <0xffffffff>;
				pinctrl-1 = <0xffffffff>;
				pinctrl-names = "mclk_on", "mclk_off";
				reg-addr-bitwidth = <0x10>;
				reg-value-bitwidth = <0x8>;
				regulator-voltages = <0x1b7740>;
				regulators = <0x38>;
				reset-gpios = <0xffffffff 0x2 0x0>;
			};
		};
	};

	fragment@modemif {
		target-path = [2f 00];

		__overlay__ {
			#address-cells = <0x2>;
			#size-cells = <0x1>;

			cp_shmem {
				compatible = "samsung,exynos-cp-shmem";
				cp_num = <0x0>;
				memory-region = <0xffffffff 0xffffffff 0xffffffff 0xffffffff>;
				use_mem_map_on_cp = <0x0>;

				regions {

					ipc {
						region,cached = <0x1>;
						region,index = <0x3>;
						region,name = "IPC";
						region,offset = <0x0>;
						region,rmem = <0x0>;
						region,size = <0x400000>;
					};

					msi {
						region,cached = <0x0>;
						region,index = <0xa>;
						region,name = "MSI";
						region,offset = <0x0>;
						region,rmem = <0x1>;
						region,size = <0x1000>;
					};

					pktproc {
						region,index = <0x6>;
						region,name = "PKTPROC";
						region,offset = <0x0>;
						region,rmem = <0x2>;
						region,size = <0x1c00000>;
					};

					pktproc_ul {
						region,index = <0x7>;
						region,name = "PKTPROC_UL";
						region,offset = <0x0>;
						region,rmem = <0x3>;
						region,size = <0x400000>;
					};
				};
			};

			cpif {
				ap2cp_handover_block_info = <0x2 0x82c>;
				ap2cp_kerneltime = <0x2 0x824>;
				ap2cp_msg = <0x2 0x800>;
				ap2cp_united_status = <0x2 0x808>;
				ap_capability_0 = <0x0>;
				ap_capability_1 = <0x0>;
				capability_offset = <0xa0>;
				compatible = "samsung,exynos-cp";
				cp2ap_msg = <0x2 0x804>;
				cp2ap_united_status = <0x2 0x80c>;
				cpboot_spi_bus_num = <0x9>;
				gpio_ap2cp_cp_pwr_on = <0xffffffff 0x0 0x1>;
				gpio_ap2cp_dump_noti = <0xffffffff 0x3 0x1>;
				gpio_ap2cp_nreset_n = <0xffffffff 0x3 0x1>;
				gpio_ap2cp_pda_active = <0xffffffff 0x1 0x1>;
				gpio_ap2cp_wake_up = <0xffffffff 0x2 0x1>;
				gpio_cp2ap_cp_ps_hold = <0xffffffff 0x5 0x1>;
				gpio_cp2ap_phone_active = <0xffffffff 0x2 0x1>;
				gpio_cp2ap_wake_up = <0xffffffff 0x4 0x1>;
				legacy_fmt_buffer_offset = <0x1000>;
				legacy_fmt_head_tail_offset = <0x8>;
				legacy_fmt_rxq_size = <0x1000>;
				legacy_fmt_txq_size = <0x1000>;
				legacy_raw_buffer_offset = <0x3000>;
				legacy_raw_head_tail_offset = <0x18>;
				legacy_raw_qos_buffer_offset = <0x400000>;
				legacy_raw_qos_head_tail_offset = <0x30>;
				legacy_raw_qos_rxq_size = <0x100000>;
				legacy_raw_qos_txq_size = <0x100000>;
				legacy_raw_rxq_size = <0x200000>;
				legacy_raw_txq_size = <0x1fd000>;
				mif,capability_check = <0x1>;
				mif,cp2ap_active_not_alive = <0x1>;
				mif,cp_num = <0x0>;
				mif,int_ap2cp_active = <0x3>;
				mif,int_ap2cp_lcd_status = <0x4>;
				mif,int_ap2cp_msg = <0x0>;
				mif,int_ap2cp_pcie_link_ack = <0xe>;
				mif,int_ap2cp_status = <0x2>;
				mif,int_ap2cp_uart_noti = <0xf>;
				mif,int_ap2cp_wakeup = <0x1>;
				mif,interrupt_types = <0x1>;
				mif,ipc_version = <0x32>;
				mif,irq_cp2ap_active = <0x3>;
				mif,irq_cp2ap_msg = <0x0>;
				mif,irq_cp2ap_ratmode = <0x9>;
				mif,irq_cp2ap_status = <0x2>;
				mif,irq_cp2ap_wakelock = <0x8>;
				mif,link_attrs = <0xfc8>;
				mif,link_name = "PCIE";
				mif,link_type = <0x1>;
				mif,modem_type = <0x1>;
				mif,name = "s5123";
				mif,protocol = <0x1>;
				offset_capability_offset = <0x70>;
				offset_srinfo_offset = <0x64>;
				pci_ch_num = <0x0>;
				pci_db_addr = <0x40060000>;
				pinctrl-0 = <0x3f 0x40 0x41 0x42 0x43 0x44 0x45 0x46>;
				pinctrl-names = "default";
				pktproc_buff_rgn_cached = <0x1>;
				pktproc_buff_rgn_offset = <0x100000>;
				pktproc_cp_base = <0x20000000>;
				pktproc_desc_mode = <0x1>;
				pktproc_desc_num_ratio_percent = <0x64>;
				pktproc_desc_rgn_offset = <0x100>;
				pktproc_desc_rgn_size = <0xfff00>;
				pktproc_exclusive_irq_idx = <0x2 0x3 0x4 0x5>;
				pktproc_info_desc_rgn_cached = <0x1>;
				pktproc_info_rgn_offset = <0x0>;
				pktproc_info_rgn_size = <0x100>;
				pktproc_max_packet_size = <0x800>;
				pktproc_num_queue = <0x1>;
				pktproc_support = <0x1>;
				pktproc_support_ul = <0x1>;
				pktproc_ul_buff_rgn_cached = <0x1>;
				pktproc_ul_buff_rgn_offset = <0x100000>;
				pktproc_ul_cp_base = <0x26000000>;
				pktproc_ul_desc_rgn_offset = <0x100>;
				pktproc_ul_desc_rgn_size = <0xfff00>;
				pktproc_ul_info_desc_rgn_cached = <0x1>;
				pktproc_ul_info_rgn_offset = <0x0>;
				pktproc_ul_info_rgn_size = <0x100>;
				pktproc_ul_max_packet_size = <0x800>;
				pktproc_ul_num_queue = <0x2>;
				pktproc_ul_padding_required = <0x1>;
				pktproc_ul_use_hw_iocc = <0x1>;
				pktproc_use_36bit_data_addr = <0x0>;
				pktproc_use_buff_mng = <0x0>;
				pktproc_use_dedicated_baaw = <0x1>;
				pktproc_use_exclusive_irq = <0x0>;
				pktproc_use_hw_iocc = <0x1>;
				pktproc_use_napi = <0x1>;
				pktproc_version = <0x2>;
				s2mpu = <0xffffffff>;
				sbi_ap2cp_kerneltime_sec_mask = <0xfff>;
				sbi_ap2cp_kerneltime_sec_pos = <0x14>;
				sbi_ap2cp_kerneltime_usec_mask = <0xfffff>;
				sbi_ap2cp_kerneltime_usec_pos = <0x0>;
				sbi_ap_status_mask = <0xf>;
				sbi_ap_status_pos = <0x1>;
				sbi_cp2ap_wakelock_mask = <0x1>;
				sbi_cp2ap_wakelock_pos = <0x6>;
				sbi_cp_rat_mode_mask = <0x3f>;
				sbi_cp_rat_mode_pos = <0x1a>;
				sbi_cp_status_mask = <0xf>;
				sbi_cp_status_pos = <0x1>;
				sbi_crash_type_mask = <0xf>;
				sbi_crash_type_pos = <0x17>;
				sbi_ds_det_mask = <0x3>;
				sbi_ds_det_pos = <0xe>;
				sbi_lcd_status_mask = <0x1>;
				sbi_lcd_status_pos = <0x1b>;
				sbi_lte_active_mask = <0x1>;
				sbi_lte_active_pos = <0x5>;
				sbi_pda_active_mask = <0x1>;
				sbi_pda_active_pos = <0x5>;
				sbi_uart_noti_mask = <0x1>;
				sbi_uart_noti_pos = <0x10>;
				srinfo_offset = <0x300>;
				srinfo_size = <0x400>;
				status = "okay";

				cpif_tpmon {
					tpmon_boost_hold_msec = <0x1770>;
					tpmon_monitor_hold_msec = <0xbb8>;
					tpmon_monitor_interval_msec = <0x64>;
					tpmon_monitor_stop_mbps = <0xf>;
					tpmon_trigger_mbps = <0x1e>;
					tpmon_trigger_msec_max = <0x1f4>;
					tpmon_trigger_msec_min = <0x64>;
					tpmon_unboost_tp_percent = <0x28>;

					tpmon_cpu_cl0 {
						tpmon,check_udp = <0x1>;
						tpmon,enable = <0x0>;
						tpmon,idx = <0x0>;
						tpmon,measure = <0x0>;
						tpmon,name = "CL0";
						tpmon,target = <0x9>;
						tpmon,threshold = <0x64 0x12c>;
						tpmon,values = <0x0 0x104410 0x137090>;
					};

					tpmon_cpu_cl1 {
						tpmon,check_udp = <0x0>;
						tpmon,enable = <0x1>;
						tpmon,idx = <0x4>;
						tpmon,measure = <0x0>;
						tpmon,name = "CL1";
						tpmon,target = <0xa>;
						tpmon,threshold = <0x7d0>;
						tpmon,values = <0x0 0x196018>;
					};

					tpmon_gro_flush_time {
						tpmon,enable = <0x1>;
						tpmon,idx = <0x0>;
						tpmon,measure = <0x0>;
						tpmon,name = "GRO";
						tpmon,target = <0x1>;
						tpmon,threshold = <0xc8>;
						tpmon,values = <0x186a0 0x1e8480>;
					};

					tpmon_irq_affinity_0 {
						tpmon,enable = <0x0>;
						tpmon,idx = <0x0>;
						tpmon,measure = <0x0>;
						tpmon,name = "IRQ_0";
						tpmon,target = <0x5>;
						tpmon,threshold = <0x1f4>;
						tpmon,values = <0x0 0x5>;
					};

					tpmon_irq_affinity_dit {
						tpmon,enable = <0x1>;
						tpmon,idx = <0x0>;
						tpmon,measure = <0x0>;
						tpmon,name = "IRQ_DIT";
						tpmon,target = <0x6>;
						tpmon,threshold = <0xfa>;
						tpmon,values = <0x2 0x5>;
					};

					tpmon_irq_affinity_dit_pktproc_q {
						tpmon,enable = <0x1>;
						tpmon,idx = <0x0>;
						tpmon,measure = <0x2>;
						tpmon,name = "IRQ_DIT_PKTPROC_Q";
						tpmon,target = <0x6>;
						tpmon,threshold = <0x1770>;
						tpmon,urgent = <0x1>;
						tpmon,values = <0x2 0x5>;
					};

					tpmon_irq_affinity_dit_q {
						tpmon,enable = <0x1>;
						tpmon,idx = <0x0>;
						tpmon,measure = <0x3>;
						tpmon,name = "IRQ_DIT_Q";
						tpmon,target = <0x6>;
						tpmon,threshold = <0x1b58>;
						tpmon,urgent = <0x1>;
						tpmon,values = <0x2 0x5>;
					};

					tpmon_mif {
						tpmon,check_udp = <0x1>;
						tpmon,enable = <0x1>;
						tpmon,idx = <0x0>;
						tpmon,measure = <0x0>;
						tpmon,name = "MIF";
						tpmon,target = <0x2>;
						tpmon,threshold = <0x44c>;
						tpmon,values = <0x0 0xf78f0>;
					};

					tpmon_pcie_low_power {
						tpmon,enable = <0x1>;
						tpmon,idx = <0x0>;
						tpmon,measure = <0x0>;
						tpmon,name = "PCIE_LP";
						tpmon,target = <0x3>;
						tpmon,threshold = <0xbb8>;
						tpmon,values = <0x1 0x0>;
					};

					tpmon_rps_q {
						tpmon,enable = <0x0>;
						tpmon,idx = <0x0>;
						tpmon,measure = <0x1>;
						tpmon,name = "RPS_Q";
						tpmon,target = <0x0>;
						tpmon,threshold = <0xbb8>;
						tpmon,values = <0x3 0xc0>;
					};

					tpmon_rps_tp {
						tpmon,enable = <0x1>;
						tpmon,idx = <0x0>;
						tpmon,measure = <0x0>;
						tpmon,name = "RPS_TP";
						tpmon,target = <0x0>;
						tpmon,threshold = <0xfa 0x640>;
						tpmon,values = <0x3 0x30 0xc0>;
					};
				};

				iodevs {

					io_device_0 {
						iod,attrs = <0x2000>;
						iod,ch = <0xf5>;
						iod,ch_count = <0x2>;
						iod,format = <0x0>;
						iod,io_type = <0x1>;
						iod,link_type = <0x1>;
						iod,name = "umts_ipc";
					};

					io_device_1 {
						iod,attrs = <0x0>;
						iod,ch = <0x29>;
						iod,format = <0x1>;
						iod,io_type = <0x1>;
						iod,link_type = <0x1>;
						iod,name = "umts_rfs0";
					};

					io_device_10 {
						iod,attrs = <0x0>;
						iod,ch = <0x5c>;
						iod,format = <0x1>;
						iod,io_type = <0x1>;
						iod,link_type = <0x1>;
						iod,name = "umts_rcs1";
					};

					io_device_11 {
						iod,attrs = <0x0>;
						iod,ch = <0x5d>;
						iod,format = <0x0>;
						iod,io_type = <0x1>;
						iod,link_type = <0x1>;
						iod,name = "umts_wfc0";
					};

					io_device_12 {
						iod,attrs = <0x0>;
						iod,ch = <0x5e>;
						iod,format = <0x1>;
						iod,io_type = <0x1>;
						iod,link_type = <0x1>;
						iod,name = "umts_wfc1";
					};

					io_device_13 {
						iod,attrs = <0x0>;
						iod,ch = <0x81>;
						iod,format = <0x0>;
						iod,io_type = <0x1>;
						iod,link_type = <0x1>;
						iod,name = "oem_ipc0";
					};

					io_device_14 {
						iod,attrs = <0x0>;
						iod,ch = <0x82>;
						iod,format = <0x0>;
						iod,io_type = <0x1>;
						iod,link_type = <0x1>;
						iod,name = "oem_ipc1";
					};

					io_device_15 {
						iod,attrs = <0x0>;
						iod,ch = <0x83>;
						iod,format = <0x0>;
						iod,io_type = <0x1>;
						iod,link_type = <0x1>;
						iod,name = "oem_ipc2";
					};

					io_device_16 {
						iod,attrs = <0x0>;
						iod,ch = <0x84>;
						iod,format = <0x0>;
						iod,io_type = <0x1>;
						iod,link_type = <0x1>;
						iod,name = "oem_ipc3";
					};

					io_device_17 {
						iod,attrs = <0x0>;
						iod,ch = <0x85>;
						iod,format = <0x0>;
						iod,io_type = <0x1>;
						iod,link_type = <0x1>;
						iod,name = "oem_ipc4";
					};

					io_device_18 {
						iod,attrs = <0x0>;
						iod,ch = <0x86>;
						iod,format = <0x0>;
						iod,io_type = <0x1>;
						iod,link_type = <0x1>;
						iod,name = "oem_ipc5";
					};

					io_device_19 {
						iod,attrs = <0x0>;
						iod,ch = <0x87>;
						iod,format = <0x0>;
						iod,io_type = <0x1>;
						iod,link_type = <0x1>;
						iod,name = "oem_ipc6";
					};

					io_device_2 {
						iod,attrs = <0x0>;
						iod,ch = <0x15>;
						iod,format = <0x1>;
						iod,io_type = <0x1>;
						iod,link_type = <0x1>;
						iod,name = "umts_router";
					};

					io_device_20 {
						iod,attrs = <0x0>;
						iod,ch = <0x88>;
						iod,format = <0x0>;
						iod,io_type = <0x1>;
						iod,link_type = <0x1>;
						iod,name = "oem_ipc7";
					};

					io_device_3 {
						iod,attrs = <0x0>;
						iod,ch = <0x51>;
						iod,format = <0x1>;
						iod,io_type = <0x1>;
						iod,link_type = <0x1>;
						iod,name = "umts_dm0";
					};

					io_device_4 {
						iod,attrs = <0x0>;
						iod,ch = <0x52>;
						iod,format = <0x1>;
						iod,io_type = <0x1>;
						iod,link_type = <0x1>;
						iod,name = "umts_loopback";
					};

					io_device_5 {
						iod,attrs = <0x2000>;
						iod,ch = <0xb5>;
						iod,ch_count = <0x1e>;
						iod,format = <0x1>;
						iod,io_type = <0x2>;
						iod,link_type = <0x1>;
						iod,name = "rmnet";
					};

					io_device_6 {
						iod,attrs = <0x0>;
						iod,ch = <0xd3>;
						iod,format = <0x1>;
						iod,io_type = <0x2>;
						iod,link_type = <0x1>;
						iod,name = "dummy";
					};

					io_device_7 {
						iod,attrs = <0x0>;
						iod,ch = <0x0>;
						iod,format = <0x3>;
						iod,io_type = <0x3>;
						iod,link_type = <0x1>;
						iod,name = "multipdp";
					};

					io_device_8 {
						iod,attrs = <0x200>;
						iod,ch = <0xf1>;
						iod,format = <0x4>;
						iod,io_type = <0x0>;
						iod,link_type = <0x1>;
						iod,name = "umts_boot0";
					};

					io_device_9 {
						iod,attrs = <0x0>;
						iod,ch = <0x5b>;
						iod,format = <0x0>;
						iod,io_type = <0x1>;
						iod,link_type = <0x1>;
						iod,name = "umts_rcs0";
					};
				};
			};
		};
	};

	fragment@typec {
		target-path = [2f 00];

		__overlay__ {

			google,usbc_port_cooling_dev {
				#cooling-cells = <0x2>;
				compatible = "google,usbc_port_cooling_dev";
				extcon = <0x13>;
				google,usb-cd-connected-interval-ms = <0x2bc>;
				google,usb-cd-polling-interval-ms = <0x1388>;
				google,usb-cd-unplug-interval-sec = <0x2>;
			};
		};
	};
};
